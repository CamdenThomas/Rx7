/*
 * test_cu.cpp — desktop verification of the DCU logic (F-001)
 *
 * Compiles the REAL climate.h + panel.h + can_map.h from ../control-unit/firmware/cu. Covers the
 * seat interlock (D-073), comfort gating, keypad edges, servo mapping, the
 * SD climate-memory CRC, and F-017: the key matrix, 0x400, wake and replay,
 * the release select (D-370) and its interlock - stopped only, 1.5 s at most
 * (D-465) - knobs, windows (D-363), mirrors (D-359,
 * D-360), one servo at a time (D-379), the NTCs, current and mirror heat;
 * and D-452: the pin map (pins.h), the TCA9539-Q1 expander's ports, its
 * reset as the DRV8962's fault clear, and CAN STB held low (tca9539.h); Y8:
 * the logic rows' terms the DCU supplies over 0x400, from logic_vectors.h; and
 * F-018 (D-492): the centre knob's modes and their rest, the fan-mode key, the
 * seat knobs, the mirror select, the mirror-defog key, the window switches as
 * paired contacts, the lights (lights.h) and the screen's pages (screen.h); F-019
 * (D-577, D-578): the dash-light level - its PWM, the backlight with it, the
 * held push on the centre knob, the screen - and the second expander U13 with
 * the wake request and the STATUS lines.
 *
 * Build (g++ on PATH):
 *   g++ test_cu.cpp -o test_cu -std=c++17 -O2 -I../control-unit/firmware/cu && ./test_cu
 */
#include <cstdio>
#include <cstring>
#include <vector>
#include "climate.h"
#include "panel.h"
#include "pins.h"
#include "tca9539.h"
#include "lights.h"
#include "screen.h"
#include "screen_knob.h"
#include "logic_vectors.h"   /* generated by gen_logic_vectors.py (run.sh) */

/* ---------- the LED drivers' bus (lights.h's one call), recorded ---------- */
struct LedWrite { uint8_t addr; std::vector<uint8_t> bytes; };
static std::vector<LedWrite> g_led;
static bool g_led_nack_panel = false;
uint8_t lights_hal_write(uint8_t addr, const uint8_t *buf, uint8_t n) {
    if (addr == LED_PANEL_ADDR && g_led_nack_panel) return 0;
    if (addr != LED_PANEL_ADDR && addr != LED_PLATE_ADDR) return 0;
    if (n > 32) return 0;                                   /* Wire's buffer */
    g_led.push_back({ addr, std::vector<uint8_t>(buf, buf + n) });
    return 1;
}

/* ---------- a TCA9539 on a mocked bus (tca9539.h's four calls) ----------
 * The model keeps the registers as the datasheet does - reset makes every
 * port an input and the output registers 0xFF; a write's data bytes
 * alternate within the register pair - and after every transaction it
 * records what each PIN is: an output port drives its register bit, an
 * input port floats to what is on it - nSLEEP (R35) and STB (R8) pulled
 * down, the DRV8962's IN / EN and the PROFETs' DEN / DSEL on their internal
 * pull-downs; nFAULT (R36) and power-good (R3) pulled up; P17 (SN28's IN) on R60. */
struct ExpModel {
    uint16_t out = 0xFFFF, pol = 0, cfg = 0xFFFF, in = 0xFFFF;
    bool nack = false, in_reset = false;
    int resets = 0, reads = 0;
    std::vector<uint8_t> regs_written;           /* the register byte of each write */
    std::vector<uint16_t> pins;                  /* pin levels after each transaction */
};
static ExpModel g_exp;                           /* U12, 0x74                          */
static ExpModel g_exp2;                          /* U13, 0x75 (Y11): the same RESET line,
                                                  * the wake request pulled down (NPN base) */
static uint16_t exp_pin_levels_of(const ExpModel &x, uint16_t pulled_down) {
    uint16_t floating = (uint16_t)(x.in_reset ? 0xFFFF : x.cfg);
    uint16_t driven = (uint16_t)(x.out & ~floating);
    return (uint16_t)(driven | (floating & ~pulled_down));
}
static uint16_t exp_pin_levels()  { return exp_pin_levels_of(g_exp, EXP_OUTPUTS); }
static uint16_t exp2_pin_levels() { return exp_pin_levels_of(g_exp2, EXP2_OUTPUTS); }
static ExpModel *exp_at(uint8_t addr) {
    return addr == TCA9539_ADDR ? &g_exp : addr == TCA9539_ADDR2 ? &g_exp2 : nullptr;
}
uint8_t exp_hal_write(uint8_t addr, const uint8_t *buf, uint8_t n) {
    ExpModel *x = exp_at(addr);
    if (!x || x->nack || x->in_reset || n < 1) return 0;
    uint8_t reg = buf[0];
    x->regs_written.push_back(reg);
    for (uint8_t i = 1; i < n; i++) {
        uint8_t r = (uint8_t)((reg & 0xFE) | ((reg + i - 1) & 1));
        uint16_t *pair = r >= 6 ? &x->cfg : r >= 4 ? &x->pol : r >= 2 ? &x->out : nullptr;
        if (!pair) continue;                     /* the input registers ignore writes */
        if (r & 1) *pair = (uint16_t)((*pair & 0x00FF) | (buf[i] << 8));
        else       *pair = (uint16_t)((*pair & 0xFF00) | buf[i]);
    }
    x->pins.push_back(x == &g_exp ? exp_pin_levels() : exp2_pin_levels());
    return 1;
}
uint8_t exp_hal_read(uint8_t addr, uint8_t reg, uint8_t *buf, uint8_t n) {
    ExpModel *x = exp_at(addr);
    if (!x || x->nack || x->in_reset || reg != TCA_REG_INPUT0 || n != 2) return 0;
    x->reads++;
    buf[0] = (uint8_t)(x->in & 0xFF); buf[1] = (uint8_t)(x->in >> 8);
    return 1;
}
void exp_hal_reset(uint8_t asserted) {                /* one line, both expanders */
    for (ExpModel *x : { &g_exp, &g_exp2 }) {
        x->in_reset = asserted != 0;
        if (asserted) { x->resets++; x->out = 0xFFFF; x->pol = 0; x->cfg = 0xFFFF; }
    }
    g_exp.pins.push_back(exp_pin_levels());
    g_exp2.pins.push_back(exp2_pin_levels());
}
void exp_hal_delay_us(uint32_t) {}
static void exp_model_fresh() { g_exp = ExpModel(); g_exp2 = ExpModel(); }

static int g_pass = 0, g_fail = 0;
#define CHECK(cond, msg) do { \
    if (cond) g_pass++; \
    else { g_fail++; printf("  FAIL %s:%d  %s\n", __FILE__, __LINE__, msg); } \
} while (0)

static dcu_state_t fresh() {
    dcu_state_t s;
    memset(&s, 0, sizeof s);
    mem_defaults(&s.mem);
    return s;
}

int main() {
    printf("-- DCU logic verification --\n");

    /* ============ 1. seat interlock (D-073) — heat wins ============ */
    {
        dcu_state_t s = fresh();
        s.mem.seat_heat = 0x02;            /* driver heat level 2   */
        s.mem.seat_cool = 0x01;            /* driver cool level 1   */
        enforce_seat_interlock(&s);
        CHECK(s.mem.seat_cool == 0, "driver cool cleared when driver heat on");
        CHECK(s.comfort_on[CMF_SEAT_HEAT_DRV] == 1 && s.comfort_on[CMF_SEAT_COOL_DRV] == 0,
              "driver channels: heat on, cool off");

        s = fresh();
        s.mem.seat_heat = 0x08;            /* passenger heat        */
        s.mem.seat_cool = 0x04 | 0x01;     /* passenger + driver cool */
        enforce_seat_interlock(&s);
        CHECK(s.mem.seat_cool == 0x01, "passenger cool cleared, driver cool untouched");
        CHECK(s.comfort_on[CMF_SEAT_COOL_DRV] == 1 && s.comfort_on[CMF_SEAT_COOL_PASS] == 0
              && s.comfort_on[CMF_SEAT_HEAT_PASS] == 1,
              "flags follow per-seat, not global");

        /* exhaustive: no (heat,cool) input ever leaves both on for a seat */
        bool never = true;
        for (int h = 0; h < 16 && never; h++)
            for (int c = 0; c < 16 && never; c++) {
                s = fresh();
                s.mem.seat_heat = (uint8_t)h; s.mem.seat_cool = (uint8_t)c;
                enforce_seat_interlock(&s);
                if ((s.mem.seat_heat & 3) && (s.mem.seat_cool & 3)) never = false;
                if ((s.mem.seat_heat & 0x0C) && (s.mem.seat_cool & 0x0C)) never = false;
            }
        CHECK(never, "all 256 heat/cool combos: never both on one seat");
    }

    /* ================= 1b. blower duty (D-308, F-012) ================= */
    {
        CHECK(blower_duty_pct(0) == 0,   "blower level 0 is 0 % - off is off");
        CHECK(blower_duty_pct(1) == 33 && blower_duty_pct(2) == 67, "levels 1-2 are 33 / 67 %");
        CHECK(blower_duty_pct(3) == 100, "level 3 is 100 %");
        CHECK(blower_duty_pct(9) == 100, "an out-of-range level clamps to 100 %, never wraps");
        CHECK(CMF_COUNT == 5, "five comfort channels - nozzles and de-icer cancelled (D-329)");
    }

    /* ================= 2. comfort gating ================= */
    {
        dcu_state_t s = fresh();
        s.key_pos = KEY_RUN; s.pmu_alive = 1;
        CHECK(comfort_permitted(&s) == 1, "RUN + PMU alive permits comfort");
        s.pmu_alive = 0;
        CHECK(comfort_permitted(&s) == 0, "dead PMU blocks comfort");
        s.pmu_alive = 1; s.key_pos = KEY_ACC;
        CHECK(comfort_permitted(&s) == 0, "ACC blocks comfort");
        s.key_pos = KEY_START;
        CHECK(comfort_permitted(&s) == 0, "cranking blocks comfort");
    }

    /* ================= 3. keypad edges ================= */
    {
        dcu_state_t s = fresh();               /* defaults: VENT, 21 C */
        apply_keypad(&s, KP_MODE);
        CHECK(s.mem.mode == CLIM_HEAT, "VENT -> HEAT");
        apply_keypad(&s, KP_MODE);
        CHECK(s.mem.mode == CLIM_DEFROST, "HEAT -> DEFROST");
        apply_keypad(&s, KP_MODE);
        CHECK(s.mem.mode == CLIM_VENT, "DEFROST wraps to VENT");
        s.mem.mode = CLIM_AC;                  /* out-of-cycle (corrupt/AC) */
        apply_keypad(&s, KP_MODE);
        CHECK(s.mem.mode == CLIM_VENT, "out-of-cycle mode lands on VENT");
        s.mem.mode = CLIM_OFF;
        apply_keypad(&s, KP_MODE);
        CHECK(s.mem.mode == CLIM_VENT, "OFF lands on VENT");

        s = fresh();
        for (int i = 0; i < 20; i++) apply_keypad(&s, KP_TEMP_UP);
        CHECK(s.mem.target_c == 30, "temp clamps at 30");
        for (int i = 0; i < 40; i++) apply_keypad(&s, KP_TEMP_DN);
        CHECK(s.mem.target_c == 16, "temp clamps at 16");

        uint8_t r0 = s.mem.recirc;
        apply_keypad(&s, KP_RECIRC);
        CHECK(s.mem.recirc == (r0 ^ 1), "recirc toggles");
        apply_keypad(&s, KP_RECIRC);
        CHECK(s.mem.recirc == r0, "recirc toggles back");
    }

    /* ================= 4. servo mapping ================= */
    {
        dcu_state_t s = fresh();               /* cal 1000..2000 us */
        s.mem.mode = CLIM_VENT;    mode_to_servos(&s);
        CHECK(s.mem.cal[SRV_MODE].us_now == 1000, "VENT -> mode door min");
        s.mem.mode = CLIM_HEAT;    mode_to_servos(&s);
        CHECK(s.mem.cal[SRV_MODE].us_now == 1500, "HEAT -> mode door mid");
        s.mem.mode = CLIM_DEFROST; mode_to_servos(&s);
        CHECK(s.mem.cal[SRV_MODE].us_now == 2000, "DEFROST -> mode door max");
        uint16_t held = s.mem.cal[SRV_MODE].us_now;
        s.mem.mode = CLIM_OFF;     mode_to_servos(&s);
        CHECK(s.mem.cal[SRV_MODE].us_now == held, "OFF leaves the door in place");

        s.mem.target_c = 16; mode_to_servos(&s);
        CHECK(s.mem.cal[SRV_BLEND].us_now == 1000, "16 C -> blend min");
        s.mem.target_c = 30; mode_to_servos(&s);
        CHECK(s.mem.cal[SRV_BLEND].us_now == 2000, "30 C -> blend max");
        s.mem.target_c = 23; mode_to_servos(&s);
        CHECK(s.mem.cal[SRV_BLEND].us_now == 1500, "23 C -> blend mid");
        s.mem.target_c = 99; mode_to_servos(&s);   /* corrupt value */
        CHECK(s.mem.cal[SRV_BLEND].us_now == 2000, "target clamps before mapping");

        /* commanded pulse can never leave the calibrated window */
        bool inWin = true;
        for (int m = 0; m <= CLIM_AC; m++)
            for (int t = 0; t < 256; t++) {
                s.mem.mode = (uint8_t)m; s.mem.target_c = (uint8_t)t;
                s.mem.recirc = (uint8_t)(t & 1);
                mode_to_servos(&s);
                for (int v = 0; v < SRV_COUNT; v++)
                    if (s.mem.cal[v].us_now < 1000 || s.mem.cal[v].us_now > 2000) inWin = false;
            }
        CHECK(inWin, "all modes x all targets: pulses stay in 1000..2000");

        s.mem.recirc = 1; mode_to_servos(&s);
        CHECK(s.mem.cal[SRV_RECIRC].us_now == 2000, "recirc -> door max");
        s.mem.recirc = 0; mode_to_servos(&s);
        CHECK(s.mem.cal[SRV_RECIRC].us_now == 1000, "fresh -> door min");
    }

    /* ================= 5. climate-memory CRC ================= */
    {
        climate_mem_t m; mem_defaults(&m);
        m.crc = mem_crc(&m);
        CHECK(m.crc == mem_crc(&m), "crc field itself is excluded from the sum");

        climate_mem_t bad = m;
        bad.target_c ^= 0x40;                  /* one flipped bit */
        CHECK(mem_crc(&bad) != m.crc, "single-bit corruption changes the CRC");

        uint8_t blob[sizeof(climate_mem_t)];   /* SD round-trip */
        memcpy(blob, &m, sizeof m);
        climate_mem_t back; memcpy(&back, blob, sizeof back);
        CHECK(back.crc == mem_crc(&back), "byte round-trip keeps a valid CRC");

        CHECK(m.mode == CLIM_VENT && m.target_c == 21, "defaults: VENT, 21 C");
    }

    /* ================= 6. key matrix and debounce (D-380, F-016) ================= */
    {
        CHECK(matrix_bit(0, 0) == PK_DEFOG && matrix_bit(0, 1) == PK_HATCH && matrix_bit(0, 2) == PK_FUEL_DOOR,
              "ROW1: defog, hatch, fuel door");
        CHECK(matrix_bit(1, 0) == PK_HVAC_MODE && matrix_bit(1, 1) == PK_RECIRC && matrix_bit(1, 2) == PK_WIN_DRV_UP,
              "ROW2: mode, recirc, DRV up");
        CHECK(matrix_bit(2, 0) == PK_WIN_DRV_DN && matrix_bit(2, 1) == PK_WIN_PASS_UP && matrix_bit(2, 2) == PK_WIN_PASS_DN,
              "ROW3: DRV down, PASS up, PASS down");
        CHECK(matrix_bit(3, 0) == PK_MIRROR_DEFOG && matrix_bit(3, 1) == PK_SPARE_R4C2 && matrix_bit(3, 2) == PK_SPARE_R4C3,
              "ROW4: mirror defog, spare, spare (D-492)");
        uint16_t all = 0; bool distinct = true;
        for (uint8_t r = 0; r < PANEL_ROWS; r++)
            for (uint8_t c = 0; c < PANEL_COLS; c++) { if (all & matrix_bit(r, c)) distinct = false; all |= matrix_bit(r, c); }
        const uint16_t off_matrix = PK_MIRROR_PRESS | PK_CENTRE_PUSH | PK_SCREEN_PUSH;
        CHECK(distinct && !(all & off_matrix) && (all | off_matrix) == (1u << PK_COUNT) - 1,
              "twelve matrix keys, the stick press and the two knob pushes: fifteen distinct 0x400 bits");
        CHECK(PK_DEFOG == 0x001 && PK_WIN_PASS_DN == 0x100 && PK_MIRROR_PRESS == 0x200 && PK_FAN_MODE == PK_HVAC_MODE,
              "append-only: every F-016 bit keeps its place");
        CHECK(PK_MIRROR_DEFOG == 0x400 && PK_CENTRE_PUSH == 0x2000,
              "F-018: mirror defog b10, spares b11-12, centre push b13");
        CHECK(PK_SCREEN_PUSH == 0x4000 && PK_COUNT == 15, "F-020: the screen knob's push b14 (D-580)");

        panel_t p; memset(&p, 0, sizeof p);
        uint16_t e = 0;
        for (int i = 0; i < KEY_DEBOUNCE_SCANS - 1; i++) e |= keys_debounce(&p, PK_RECIRC);
        CHECK(e == 0 && p.phys == 0, "a key is not down before the debounce");
        e = keys_debounce(&p, PK_RECIRC);
        CHECK(e == PK_RECIRC && p.phys == PK_RECIRC, "down after the debounce, one edge");
        CHECK(keys_debounce(&p, 0) == 0 && p.phys == PK_RECIRC, "one bounce open does not release it");
        e = 0;
        for (int i = 0; i < 20; i++) e |= keys_debounce(&p, (i & 1) ? PK_RECIRC : 0);
        CHECK(e == 0, "chatter makes no second edge");
    }

    /* ================= 7. 0x400: held, heartbeat, wake and replay (D-355) ================= */
    {
        panel_t p; memset(&p, 0, sizeof p);
        uint16_t down = 0, held = 0; uint32_t t = 10000;
        for (int i = 0; i < 10; i++, t += 5) panel_keys_step(&p, PK_WIN_DRV_UP, 1, t, &down, &held);
        CHECK(down == PK_WIN_DRV_UP && held == 0, "window key down, not yet held");
        for (int i = 0; i < 200; i++, t += 5) panel_keys_step(&p, PK_WIN_DRV_UP, 1, t, &down, &held);
        CHECK(held == PK_WIN_DRV_UP, "held after 1 s");

        keys_tx_t tx; memset(&tx, 0, sizeof tx); panel_keys_t f;
        CHECK(panel_frame_due(&tx, 1, 0, 0, 100, 0, &f) == 1 && f.down == 1 && f.counter == 0, "first frame goes");
        CHECK(panel_frame_due(&tx, 1, 0, 0, 100, 100, &f) == 0, "no change, no frame");
        CHECK(panel_frame_due(&tx, 3, 0, 0, 100, 150, &f) == 1 && f.counter == 1, "a change goes at once");
        CHECK(panel_frame_due(&tx, 3, 0, 0, 100, 649, &f) == 0 && panel_frame_due(&tx, 3, 0, 0, 100, 650, &f) == 1,
              "2 Hz heartbeat");
        CHECK(panel_frame_due(&tx, 3, 0, 1, 100, 660, &f) == 1 && f.screen_count == 1 && f.disp_pct == 100,
              "a screen-knob detent goes at once, in byte 4 (D-580)");
        CHECK(panel_frame_due(&tx, 3, 0, 1, 95, 670, &f) == 1 && f.disp_pct == 95, "a level step goes at once, in byte 5");
        CHECK(sizeof(panel_keys_t) == CAN_MSG_LEN, "0x400 payload is 8 bytes");

        /* asleep: a defog tap wakes the PMU and is replayed once it answers */
        memset(&p, 0, sizeof p); t = 20000;
        for (int i = 0; i < 6; i++, t += 5) panel_keys_step(&p, PK_DEFOG, 0, t, &down, &held);
        CHECK(p.wake_req == 1 && down == 0, "asleep: wake pulled, the edge key held back");
        for (int i = 0; i < 6; i++, t += 5) panel_keys_step(&p, 0, 0, t, &down, &held);
        CHECK(p.wake_req == 1 && p.latched == PK_DEFOG, "released before the PMU woke: latched");
        panel_keys_step(&p, 0, 1, t, &down, &held); t += 5;
        CHECK(p.wake_req == 0 && down == PK_DEFOG, "PMU alive: the tap is replayed");
        for (int i = 0; i < REPLAY_MS / 5 + 1; i++, t += 5) panel_keys_step(&p, 0, 1, t, &down, &held);
        CHECK(down == 0, "and released after the replay");

        /* a PMU that never answers drops the latched press */
        memset(&p, 0, sizeof p); t = 30000;
        for (int i = 0; i < 6; i++, t += 5) panel_keys_step(&p, PK_HATCH, 0, t, &down, &held);
        for (int i = 0; i < 6; i++, t += 5) panel_keys_step(&p, 0, 0, t, &down, &held);
        t += WAKE_REQ_MAX_MS;
        panel_keys_step(&p, 0, 0, t, &down, &held);
        CHECK(p.wake_req == 0 && p.latched == 0, "no answer in 3 s: wake and the press dropped");
        panel_keys_step(&p, 0, 1, t + 5, &down, &held);
        CHECK(down == 0 && p.rel_sel == 0, "a late PMU never pops the hatch");

        /* a CAN hiccup with defog held makes no second edge */
        memset(&p, 0, sizeof p); t = 40000;
        for (int i = 0; i < 6; i++, t += 5) panel_keys_step(&p, PK_DEFOG, 1, t, &down, &held);
        panel_keys_step(&p, PK_DEFOG, 0, t, &down, &held); t += 5;
        CHECK(down == PK_DEFOG, "PMU lost with the key held: it stays down, no new edge later");

        CHECK(sleep_due(&p, 0, DCU_SLEEP_AFTER_MS) == 0, "no sleep with a key down");
        panel_t q; memset(&q, 0, sizeof q);
        CHECK(sleep_due(&q, 0, DCU_SLEEP_AFTER_MS) == 1 && sleep_due(&q, 1, DCU_SLEEP_AFTER_MS) == 0
              && sleep_due(&q, 0, DCU_SLEEP_AFTER_MS - 1) == 0, "sleep: PMU gone, idle 30 s");
    }

    /* ================= 8. release select (D-370, D-465) ================= */
    {
        panel_t p; memset(&p, 0, sizeof p); p.stopped = 1;
        uint16_t down = 0, held = 0; uint32_t t = 50000;
        for (int i = 0; i < 4; i++, t += 5) panel_keys_step(&p, PK_HATCH, 1, t, &down, &held);
        CHECK(p.rel_sel == PK_HATCH && down == PK_HATCH, "hatch: K3 selected in the same scan the edge goes");
        for (int i = 0; i < 4; i++, t += 5) panel_keys_step(&p, PK_HATCH | PK_FUEL_DOOR, 1, t, &down, &held);
        CHECK(p.rel_sel == PK_HATCH && !(down & PK_FUEL_DOOR), "fuel door during the hatch hold: refused, kept off 0x400");
        for (int i = 0; i < 4; i++, t += 5) panel_keys_step(&p, PK_HATCH, 1, t, &down, &held);
        for (int i = 0; i < 4; i++, t += 5) panel_keys_step(&p, 0, 1, t, &down, &held);
        CHECK(p.rel_sel == PK_HATCH, "held through the pulse after the key is let go");
        t += RELEASE_HOLD_MS;
        panel_keys_step(&p, 0, 1, t, &down, &held);
        CHECK(p.rel_sel == 0, "released after the hold");

        memset(&p, 0, sizeof p); p.stopped = 1;
        for (int i = 0; i < 4; i++, t += 5) panel_keys_step(&p, PK_HATCH | PK_FUEL_DOOR, 1, t, &down, &held);
        CHECK(p.rel_sel == 0 && !(down & PK_RELEASE), "both at once: neither, and the PMU sees neither");

        /* D-465: the select is dropped 1.5 s after it was raised, whatever the key does */
        memset(&p, 0, sizeof p); p.stopped = 1; t = 60000;
        for (int i = 0; i < 4; i++, t += 5) panel_keys_step(&p, PK_FUEL_DOOR, 1, t, &down, &held);
        uint32_t t0 = p.rel_t0;
        CHECK(p.rel_sel == PK_FUEL_DOOR && (down & PK_FUEL_DOOR), "fuel door: K4 selected, the edge goes");
        while ((uint32_t)(t + 5 - t0) < RELEASE_HOLD_MS) { t += 5; panel_keys_step(&p, PK_FUEL_DOOR, 1, t, &down, &held); }
        CHECK(p.rel_sel == PK_FUEL_DOOR, "key held: still selected 5 ms before 1.5 s");
        t += 5; panel_keys_step(&p, PK_FUEL_DOOR, 1, t, &down, &held);
        CHECK(p.rel_sel == 0, "key still held: the select drops at 1.5 s (D-465)");
        for (int i = 0; i < 2000; i++) { t += 5; panel_keys_step(&p, PK_FUEL_DOOR, 1, t, &down, &held); }
        CHECK(p.rel_sel == 0 && (down & PK_FUEL_DOOR), "held 10 s more: never re-selected; 0x400 shows the key, no new edge");
        for (int i = 0; i < 6; i++) { t += 5; panel_keys_step(&p, 0, 1, t, &down, &held); }
        for (int i = 0; i < 4; i++) { t += 5; panel_keys_step(&p, PK_FUEL_DOOR, 1, t, &down, &held); }
        CHECK(p.rel_sel == PK_FUEL_DOOR, "let go and pressed again: a new select");

        /* a second press of the same key inside the window never extends it */
        memset(&p, 0, sizeof p); p.stopped = 1; t = 70000;
        for (int i = 0; i < 4; i++, t += 5) panel_keys_step(&p, PK_HATCH, 1, t, &down, &held);
        t0 = p.rel_t0;
        for (int i = 0; i < 6; i++, t += 5) panel_keys_step(&p, 0, 1, t, &down, &held);
        for (int i = 0; i < 6; i++, t += 5) panel_keys_step(&p, PK_HATCH, 1, t, &down, &held);
        CHECK(p.rel_t0 == t0 && !(down & PK_HATCH), "hatch pressed again inside 1.5 s: refused, kept off 0x400, window unchanged");
        while ((uint32_t)(t - t0) < RELEASE_HOLD_MS) { panel_keys_step(&p, PK_HATCH, 1, t, &down, &held); t += 5; }
        panel_keys_step(&p, PK_HATCH, 1, t, &down, &held);
        CHECK(p.rel_sel == 0, "and the select still drops 1.5 s after the first press");

        /* D-465: refused unless the car is stopped - 0x200's road speed at 0, fresh */
        CHECK(car_stopped(1, 0, 0, 1, KEY_RUN) == 1 && car_stopped(1, TMO_ICU_SENSORS, 0, 1, KEY_RUN) == 1, "0x200 fresh, 0 km/h: stopped");
        CHECK(car_stopped(1, 0, 1, 1, KEY_RUN) == 0 && car_stopped(1, 0, 120, 1, KEY_RUN) == 0, "1 km/h or more: moving");
        CHECK(car_stopped(1, TMO_ICU_SENSORS + 1, 0, 1, KEY_RUN) == 0, "0x200 stale (older than TMO_ICU_SENSORS): NOT stopped");
        CHECK(car_stopped(0, 0, 0, 1, KEY_RUN) == 0, "no 0x200 since boot: NOT stopped");

        /* D-484 (block 01.35 (b)): with no speed to see, the key OFF on a live PMU counts as standing */
        CHECK(car_stopped(0, 0, 0, 1, KEY_OFF) == 1, "no 0x200 (the ICU dark), PMU alive, key OFF: stopped - a key-off release");
        CHECK(car_stopped(1, TMO_ICU_SENSORS + 1, 0, 1, KEY_OFF) == 1, "0x200 stale, PMU alive, key OFF: stopped");
        CHECK(car_stopped(0, 0, 0, 0, KEY_OFF) == 0, "key OFF but the PMU not alive (0x100 stale or unseen): NOT stopped");
        CHECK(car_stopped(0, 0, 0, 1, KEY_ACC) == 0 && car_stopped(0, 0, 0, 1, KEY_RUN) == 0 && car_stopped(0, 0, 0, 1, KEY_START) == 0,
              "key ACC / RUN / START with no speed to see: NOT stopped");
        CHECK(car_stopped(0, 0, 0, 1, KEY_FAULT) == 0, "a key-ladder fault is not OFF: NOT stopped");
        CHECK(car_stopped(1, 0, 30, 1, KEY_OFF) == 0, "a visible speed over 0 rules even with the key reading OFF: moving");
        CHECK(car_stopped(1, 0, 0, 0, KEY_FAULT) == 1, "a visible 0 km/h rules whatever the PMU says: stopped");

        memset(&p, 0, sizeof p); t = 80000;
        CHECK(p.stopped == 0, "a fresh panel_t refuses: stopped resets to 0");
        p.stopped = car_stopped(1, 0, 30, 1, KEY_RUN);                                  /* moving */
        for (int i = 0; i < 6; i++, t += 5) panel_keys_step(&p, PK_HATCH, 1, t, &down, &held);
        CHECK(p.rel_sel == 0 && !(down & PK_HATCH), "moving: hatch refused - no select, nothing on 0x400");
        p.stopped = car_stopped(1, 0, 0, 1, KEY_RUN);
        for (int i = 0; i < 6; i++, t += 5) panel_keys_step(&p, PK_HATCH, 1, t, &down, &held);
        CHECK(p.rel_sel == 0 && !(down & PK_HATCH), "stopped while the refused key is held: still refused until let go");
        for (int i = 0; i < 6; i++, t += 5) panel_keys_step(&p, 0, 1, t, &down, &held);
        for (int i = 0; i < 4; i++, t += 5) panel_keys_step(&p, PK_HATCH, 1, t, &down, &held);
        CHECK(p.rel_sel == PK_HATCH && (down & PK_HATCH), "let go, pressed stopped: K3 selected, the edge goes");

        memset(&p, 0, sizeof p); t = 90000;
        p.stopped = car_stopped(1, TMO_ICU_SENSORS + 50, 0, 1, KEY_RUN);                /* stale */
        for (int i = 0; i < 6; i++, t += 5) panel_keys_step(&p, PK_FUEL_DOOR, 1, t, &down, &held);
        CHECK(p.rel_sel == 0 && !(down & PK_FUEL_DOOR), "0x200 stale: fuel door refused");

        memset(&p, 0, sizeof p); p.stopped = 1; t = 95000;
        for (int i = 0; i < 4; i++, t += 5) panel_keys_step(&p, PK_HATCH, 1, t, &down, &held);
        CHECK(p.rel_sel == PK_HATCH, "stopped: K3 selected");
        p.stopped = 0;                                                      /* the car moves off, or 0x200 goes stale */
        t += 5; panel_keys_step(&p, PK_HATCH, 1, t, &down, &held);
        CHECK(p.rel_sel == 0 && !(down & PK_HATCH), "not stopped mid-select: dropped at once, the key kept off 0x400");

        /* exhaustive: over random key, PMU and speed sequences the select is never both,
         * never raised or kept while not stopped, never older than 1.5 s, and a release
         * edge reaches 0x400 only with its own relay selected */
        bool ok = true; uint32_t seed = 12345;
        memset(&p, 0, sizeof p);
        uint16_t prev_down = 0;
        for (int i = 0; i < 200000 && ok; i++, t += 5) {
            seed = seed * 1103515245u + 12345u;
            uint16_t raw = (uint16_t)((seed >> 16) & PK_RELEASE);
            uint8_t alive = ((seed >> 8) & 31) != 0;
            p.stopped = ((seed >> 3) & 15) != 0;
            panel_keys_step(&p, raw, alive, t, &down, &held);
            if (p.rel_sel != 0 && p.rel_sel != PK_HATCH && p.rel_sel != PK_FUEL_DOOR) ok = false;
            if (p.rel_sel && (!p.stopped || (uint32_t)(t - p.rel_t0) >= RELEASE_HOLD_MS)) ok = false;
            uint16_t edge = (uint16_t)(down & ~prev_down & PK_RELEASE);
            if (edge && edge != p.rel_sel) ok = false;
            prev_down = down;
        }
        CHECK(ok, "200k random scans: one relay at most, only stopped, never past 1.5 s, every release edge steered");
    }

    /* ================= 9. encoders and knobs (SN20, D-073) ================= */
    {
        enc_t e; memset(&e, 0, sizeof e); e.ab = 3;
        const uint8_t cw[4] = { 2, 0, 1, 3 };           /* 11 -> 10 -> 00 -> 01 -> 11 */
        int d = 0;
        for (int k = 0; k < 4; k++) d += enc_step(&e, cw[k]);
        CHECK(d == 1, "one clockwise detent");
        for (int k = 3; k >= 0; k--) d += enc_step(&e, k ? cw[k - 1] : 3);
        CHECK(d == 0, "one anticlockwise detent back");
        d = 0;
        for (int k = 0; k < 50; k++) { d += enc_step(&e, 2); d += enc_step(&e, 3); }
        CHECK(d == 0, "contact bounce on one edge adds nothing");

        dcu_state_t s = fresh();
        knob_t kn; memset(&kn, 0, sizeof kn);
        uint32_t t = 5000;
        panel_apply(&s, &kn, 0, 0, 2, 0, t);
        CHECK((s.mem.seat_heat & 3) == 2 && (s.mem.seat_cool & 3) == 0, "driver knob +2: heat 2");
        panel_apply(&s, &kn, 0, 0, -4, 0, t);
        CHECK((s.mem.seat_heat & 3) == 0 && (s.mem.seat_cool & 3) == 2, "then -4: through OFF to cool 2");
        panel_apply(&s, &kn, 0, 0, -9, 5, t);
        CHECK((s.mem.seat_cool & 3) == 3 && ((s.mem.seat_heat >> 2) & 3) == 3, "clamped at cool 3 / heat 3");
        bool never = true;
        for (int a = -8; a <= 8; a++) for (int b = -8; b <= 8; b++) {
            panel_apply(&s, &kn, 0, 0, a, b, t);
            if ((s.mem.seat_heat & 3) && (s.mem.seat_cool & 3)) never = false;
            if ((s.mem.seat_heat & 0xC) && (s.mem.seat_cool & 0xC)) never = false;
        }
        CHECK(never, "no knob sequence heats and cools one seat");

        s = fresh(); memset(&kn, 0, sizeof kn);
        panel_apply(&s, &kn, PK_CENTRE_PUSH, 5, 0, 0, t);
        CHECK(s.mem.blower == 3, "fan (after a push) clamps at 3");
        panel_apply(&s, &kn, 0, -9, 0, 0, t);
        CHECK(s.mem.blower == 0, "fan clamps at off");
        panel_apply(&s, &kn, PK_CENTRE_PUSH, 3, 0, 0, t);
        CHECK(s.mem.target_c == 24, "second push: back to temperature, one degree a detent");
        panel_apply(&s, &kn, PK_RECIRC, 0, 0, 0, t);
        CHECK(s.mem.recirc == 1 && s.mem.mode == CLIM_VENT, "recirc toggles; the fan-mode key not pressed, the mode unchanged");
        panel_apply(&s, &kn, PK_DEFOG | PK_HATCH | PK_MIRROR_DEFOG, 0, 0, 0, t);
        CHECK(s.mem.mode == CLIM_VENT && s.mem.recirc == 1 && kn.mode == KNOB_TEMP, "PMU keys and mirror defog do nothing to the climate");
    }

    /* ================= 10. windows (SN22, D-363) ================= */
    {
        window_t w; memset(&w, 0, sizeof w);
        uint8_t up, dn; uint32_t t = 60000;
        window_step(&w, 1, 0, 1, t, &up, &dn);
        CHECK(up == 1 && dn == 0, "up key: up relay");
        window_step(&w, 0, 1, 1, t += 5, &up, &dn);
        CHECK(up == 0 && dn == 0, "reversal: both at rest first");
        window_step(&w, 0, 1, 1, t += WINDOW_DEAD_MS - 10, &up, &dn);
        CHECK(dn == 0, "still resting inside the dead time");
        window_step(&w, 0, 1, 1, t += 10, &up, &dn);
        CHECK(dn == 1 && up == 0, "then down");
        window_step(&w, 1, 1, 1, t += 5, &up, &dn);
        CHECK(up == 0 && dn == 0, "both keys: stop");
        window_step(&w, 1, 0, 0, t += 500, &up, &dn);
        CHECK(up == 0, "not permitted: nothing");
        window_step(&w, 1, 0, 1, t += 5, &up, &dn);
        window_step(&w, 1, 0, 1, t += WINDOW_MAX_RUN_MS, &up, &dn);
        CHECK(up == 0, "held past the run limit: stops");
        window_step(&w, 1, 0, 1, t += 500, &up, &dn);
        CHECK(up == 0, "and stays stopped until let go");
        window_step(&w, 0, 0, 1, t += 5, &up, &dn);
        window_step(&w, 1, 0, 1, t += WINDOW_DEAD_MS, &up, &dn);
        CHECK(up == 1, "let go and pressed again: runs");

        bool never = true; uint32_t seed = 777;
        memset(&w, 0, sizeof w);
        for (int i = 0; i < 100000 && never; i++) {
            seed = seed * 1103515245u + 12345u;
            window_step(&w, (seed >> 16) & 1, (seed >> 17) & 1, ((seed >> 18) & 7) != 0,
                        t += (seed >> 20) & 63, &up, &dn);
            if (up && dn) never = false;
        }
        CHECK(never, "100k random steps: up and down never together");
    }

    /* ================= 11. mirrors (SN17, D-359, D-360) ================= */
    {
        stick_cal_t c; stick_defaults(&c);
        uint8_t axis; int8_t dir;
        stick_read(&c, 2048 + 300, 2048, &axis, &dir);
        CHECK(axis == AXIS_NONE, "inside the dead band: nothing");
        stick_read(&c, 4000, 2600, &axis, &dir);
        CHECK(axis == AXIS_X && dir == MIRROR_SIGN_X, "the larger deflection wins");
        stick_read(&c, 2048, 100, &axis, &dir);
        CHECK(axis == AXIS_Y && dir == -MIRROR_SIGN_Y, "Y the other way");

        mirror_t m; memset(&m, 0, sizeof m); mirror_out_t o; uint32_t t = 70000;
        mirror_step(&m, 0, AXIS_X, 1, 1, t, &o);
        CHECK(o.left == HB_HIGH && o.common == HB_LOW && o.right == HB_OFF, "left side by default, right open");
        CHECK(o.clutch == (AXIS_X == MIRROR_CLUTCH_AXIS), "clutch follows the axis");
        mirror_step(&m, 0, AXIS_X, -1, 1, t += 5, &o);
        CHECK(o.left == HB_OFF && o.common == HB_OFF, "reversal: bridges open first");
        mirror_step(&m, 0, AXIS_X, -1, 1, t += MIRROR_DEAD_MS, &o);
        CHECK(o.left == HB_LOW && o.common == HB_HIGH, "then reversed polarity");
        mirror_step(&m, PK_MIRROR_PRESS, AXIS_Y, 1, 1, t += 5, &o);
        CHECK(m.side == MIRROR_RIGHT && o.left == HB_OFF && o.right == HB_OFF, "press: side toggles, all stop");
        CHECK(o.clutch == (AXIS_Y == MIRROR_CLUTCH_AXIS), "clutch settles during the dead time");
        mirror_step(&m, 0, AXIS_Y, 1, 1, t += MIRROR_DEAD_MS, &o);
        CHECK(o.right == HB_HIGH && o.left == HB_OFF, "right mirror moves, left open");
        mirror_step(&m, 0, AXIS_Y, 1, 0, t += 5, &o);
        CHECK(o.right == HB_OFF && o.common == HB_OFF && o.clutch == 0, "not permitted: everything open");

        bool ok = true; uint32_t seed = 4242;
        memset(&m, 0, sizeof m);
        for (int i = 0; i < 100000 && ok; i++) {
            seed = seed * 1103515245u + 12345u;
            uint8_t ax = (uint8_t)((seed >> 16) % 3);
            int8_t  dr = ax ? (((seed >> 18) & 1) ? 1 : -1) : 0;
            mirror_step(&m, ((seed >> 19) & 15) == 0 ? PK_MIRROR_PRESS : 0, ax, dr,
                        ((seed >> 23) & 7) != 0, t += (seed >> 24) & 31, &o);
            if (o.left != HB_OFF && o.right != HB_OFF) ok = false;          /* one mirror at a time */
            if ((o.left != HB_OFF || o.right != HB_OFF) == (o.common == HB_OFF)) ok = false;
            if (o.common != HB_OFF && (o.left == o.common || o.right == o.common)) ok = false;
        }
        CHECK(ok, "100k random steps: one side driven, always against the common");
    }

    /* ================= 12. servos one at a time (D-379) ================= */
    {
        dcu_state_t s = fresh();
        mode_to_servos(&s);                    /* targets 1000 / 1357 / 1000 us */
        servo_seq_t q; memset(&q, 0, sizeof q);
        uint32_t t = 80000;
        CHECK(servo_seq_step(&q, s.mem.cal, t) >= 0, "first servo moves");
        CHECK(servo_seq_step(&q, s.mem.cal, t + SERVO_SETTLE_MS - 1) == -1, "the next waits for the settle");
        CHECK(servo_seq_step(&q, s.mem.cal, t + SERVO_SETTLE_MS) >= 0, "then moves");
        CHECK(servo_seq_step(&q, s.mem.cal, t + 2 * SERVO_SETTLE_MS) >= 0, "third");
        CHECK(servo_seq_step(&q, s.mem.cal, t + 3 * SERVO_SETTLE_MS) == -1, "nothing left to move");
        bool same = true;
        for (int i = 0; i < SRV_COUNT; i++) if (q.applied[i] != s.mem.cal[i].us_now) same = false;
        CHECK(same, "every servo reached its target");
    }

    /* ================= 13. analog inputs and mirror heat ================= */
    {
        CHECK(ntc_to_c(2048) == 25, "NTC at mid-scale reads 25 C");
        CHECK(ntc_to_c(0) == TEMP_INVALID && ntc_to_c(4095) == TEMP_INVALID, "short and open read blank");
        CHECK(ntc_to_c(1000) > 25 && ntc_to_c(3000) < 25, "hotter pulls the divider down");
        CHECK(comfort_current_ca(1241, 0) == 1000, "1.0 V at the ADC is 10.00 A");
        CHECK(comfort_current_ca(50, 60) == 0, "below the zero reads 0, never wraps");

        pmu_outputs_t m; memset(&m, 0, sizeof m);
        m.out_state[0] = 0x08;
        CHECK(pmu_out_on(&m, PMU_OUT_DEFOG) == 1 && pmu_out_on(&m, 0) == 0, "O4 is 0x120 byte 2 bit 3");
        m.out_state[2] = 0x80;
        CHECK(pmu_out_on(&m, 23) == 1, "O24 is byte 4 bit 7");
    }

    /* ================= 14. pin map (pins.h = dcu_channels.teensy_pin, D-452) ================= */
    {
        int uses[64] = { 0 };
        auto use = [&](int p) { if (p >= 0 && p < 64) uses[p]++; };
        use(PIN_CAN_RX); use(PIN_CAN_TX);
        for (int p : PIN_SERVO) use(p);
        for (int p : PIN_COMFORT) use(p);
        use(PIN_BLOWER); use(PIN_DASH); use(PIN_EXP_INT); use(PIN_EXP_RESET);
        use(PIN_CABIN_NTC); use(PIN_OAT_NTC); use(PIN_CURRENT); use(PIN_JOY_PRESS);
        use(PIN_I2C_SDA); use(PIN_I2C_SCL); use(PIN_JOY_X); use(PIN_JOY_Y);
        for (int p : PIN_WIN) use(p);
        use(PIN_REL_HATCH); use(PIN_REL_FUEL);
        for (int p : PIN_ROW) use(p);
        for (int p : PIN_COL) use(p);
        for (int i = 0; i < ENC_COUNT; i++) { use(PIN_ENC_A[i]); use(PIN_ENC_B[i]); }
        use(PIN_CENTRE_PUSH);
        bool once = true, pads = true;
        for (int p = 0; p <= 41; p++) if (uses[p] != 1) once = false;
        for (int p = 42; p < 64; p++) if (uses[p] != 0) pads = false;
        CHECK(once, "every edge pin 0-41 used exactly once (D-452: all 42)");
        CHECK(pads, "nothing on the bottom pads 48-54 (or any pad past 41)");

        CHECK(ENC_COUNT == 3 && PIN_ENC_A[ENC_CENTRE] == 40 && PIN_ENC_B[ENC_CENTRE] == 41,
              "three encoders; the centre knob on 40 / 41, the old fan encoder's pins (SN20, D-452, D-492)");
        CHECK(PIN_CENTRE_PUSH == 34 && PIN_ROW[3] == 35, "the knob's push on 34 (ribbon 11), ROW4 on 35 (ribbon 12) - D-492");
        CHECK(PIN_ENC_A[ENC_SEAT_DRV] == 36 && PIN_ENC_B[ENC_SEAT_DRV] == 37
              && PIN_ENC_A[ENC_SEAT_PASS] == 38 && PIN_ENC_B[ENC_SEAT_PASS] == 39,
              "driver seat 36 / 37, passenger seat 38 / 39");
        CHECK(PIN_I2C_SDA == 18 && PIN_I2C_SCL == 19 && PIN_EXP_INT == 12 && PIN_EXP_RESET == 13,
              "the expander on Wire 18 / 19, INT 12, RESET 13 (SN17)");
        bool no_enc_on_i2c = true;
        for (int i = 0; i < ENC_COUNT; i++)
            if (PIN_ENC_A[i] == 18 || PIN_ENC_A[i] == 19 || PIN_ENC_B[i] == 18 || PIN_ENC_B[i] == 19) no_enc_on_i2c = false;
        CHECK(no_enc_on_i2c, "no encoder left on the I2C pins");
        CHECK(sizeof PIN_ROW / sizeof PIN_ROW[0] == PANEL_ROWS && sizeof PIN_COL / sizeof PIN_COL[0] == PANEL_COLS
              && PIN_ROW[0] == 28 && PIN_ROW[2] == 30 && PIN_COL[0] == 31 && PIN_COL[2] == 33,
              "matrix rows 28-30 and 35, columns 31-33 (SN19)");
        CHECK(PIN_JOY_X == 20 && PIN_JOY_Y == 21 && PIN_JOY_PRESS == 17, "thumbstick A6 / A7, press 17 (SN18)");
        CHECK(PIN_WIN[0] == 22 && PIN_WIN[1] == 23 && PIN_WIN[2] == 24 && PIN_WIN[3] == 25, "windows 22-25 (SN22)");
        CHECK(PIN_REL_HATCH == 26 && PIN_REL_FUEL == 27 && PIN_DASH == 11 && PIN_BLOWER == 10,
              "release 26 / 27 (SN23), the dash-light stage 11 (SN31, D-577 - was the wake), blower 10 (SN14)");
        CHECK(PIN_COMFORT[CMF_SEAT_HEAT_DRV] == 5 && PIN_COMFORT[CMF_SEAT_HEAT_PASS] == 6
              && PIN_COMFORT[CMF_SEAT_COOL_DRV] == 7 && PIN_COMFORT[CMF_SEAT_COOL_PASS] == 8
              && PIN_COMFORT[CMF_MIRROR_HEAT] == 9, "comfort 5-9 in climate.h's order (SN16)");
        CHECK(PIN_CABIN_NTC == 14 && PIN_OAT_NTC == 15 && PIN_CURRENT == 16 && PIN_SERVO[0] == 2 && PIN_SERVO[2] == 4,
              "NTCs A0 / A1, current A2, servos 2-4");
        CHECK(sizeof PIN_SERVO / sizeof PIN_SERVO[0] == SRV_COUNT && sizeof PIN_COMFORT / sizeof PIN_COMFORT[0] == CMF_COUNT,
              "one pin per servo and per comfort channel");
    }

    /* ================= 15. the expander's ports (TCA9539-Q1, SN17 / SN22 / SN16 / SN26 / SN24) ================= */
    {
        CHECK(TCA_REG_INPUT0 == 0x00 && TCA_REG_OUTPUT0 == 0x02 && TCA_REG_POLARITY0 == 0x04 && TCA_REG_CONFIG0 == 0x06,
              "register map: input 0/1, output 2/3, polarity 4/5, config 6/7");
        CHECK(TCA9539_ADDR == 0x74, "address 0x74: A0 = A1 = GND on the sheet (confirm)");
        CHECK(EXP_MIR_IN1 == 0x0001 && EXP_MIR_EN1 == 0x0002 && EXP_MIR_IN2 == 0x0004 && EXP_MIR_EN2 == 0x0008
              && EXP_MIR_IN3 == 0x0010 && EXP_MIR_EN3 == 0x0020, "P00-P05: IN1 / EN1 - IN3 / EN3");
        CHECK(EXP_MIR_EN4 == 0x0040 && EXP_MIR_NSLEEP == 0x0080 && EXP_MIR_NFAULT == 0x0100,
              "P06 EN4 (clutch), P07 nSLEEP, P10 nFAULT");
        CHECK(EXP_WIN_DEN == 0x0200 && EXP_WIN_DSEL0 == 0x0400 && EXP_WIN_DSEL1 == 0x0800 && EXP_MH_DEN == 0x1000,
              "P11-P13 window DEN / DSEL0 / DSEL1, P14 mirror-heat DEN");
        CHECK(EXP_CAN_STB == 0x2000 && EXP_PG_5V == 0x4000 && EXP_P17 == 0x8000, "P15 CAN STB, P16 power-good, P17");
        CHECK(EXP_INPUTS == 0x4100, "inputs: nFAULT, power-good - every other port drives, P17 (SN28's IN) held low");
        CHECK(TCA9539_ADDR2 == 0x75 && EXP2_SEAT_STATUS == 0x0001 && EXP2_RADAR == 0x0002 && EXP2_WAKE == 0x0004
              && EXP2_DASH_STATUS == 0x0008, "U13 at 0x75: P00 seat STATUS, P01 radar, P02 wake, P03 dash STATUS (Y11, D-577)");
        CHECK(EXP2_OUTPUTS == EXP2_WAKE && EXP2_INPUTS == (uint16_t)~EXP2_WAKE, "U13 drives the wake request only");

        mirror_out_t mo; memset(&mo, 0, sizeof mo);
        CHECK(exp_word(&mo, 0, 0) == 0, "asleep: nothing but low");
        CHECK(exp_word(&mo, 1, 1) == EXP_MIR_NSLEEP, "awake, at rest: nSLEEP only, every bridge open");
        mo.common = HB_LOW; mo.left = HB_HIGH; mo.clutch = 1;
        CHECK(exp_word(&mo, 1, 1) == (EXP_MIR_NSLEEP | EXP_MIR_EN1 | EXP_MIR_IN2 | EXP_MIR_EN2 | EXP_MIR_EN4),
              "left up: common low, left high, clutch sinking");
        CHECK(exp_word(&mo, 1, 0) == EXP_MIR_NSLEEP, "not live (waking or faulted): every EN off");
        CHECK(exp_word(&mo, 0, 1) == 0, "asleep: no EN either");
        mo.common = HB_HIGH; mo.left = HB_OFF; mo.right = HB_LOW; mo.clutch = 0;
        CHECK(exp_word(&mo, 1, 1) == (EXP_MIR_NSLEEP | EXP_MIR_IN1 | EXP_MIR_EN1 | EXP_MIR_EN3),
              "right the other way: common high, right low, clutch open");

        CHECK(exp_open_first(EXP_MIR_EN1, EXP_MIR_EN1 | EXP_MIR_IN1) == 0, "a live bridge changing rail opens first");
        CHECK(exp_open_first(EXP_MIR_EN1, EXP_MIR_EN1 | EXP_MIR_EN2) == EXP_MIR_EN1, "a new channel needs no gap");

        /* the mirror step through the word: one head, against the common, STB never */
        bool ok = true; uint32_t seed = 9090, t = 90000;
        mirror_t m; memset(&m, 0, sizeof m);
        for (int i = 0; i < 100000 && ok; i++) {
            seed = seed * 1103515245u + 12345u;
            uint8_t ax = (uint8_t)((seed >> 16) % 3);
            int8_t  dr = ax ? (((seed >> 18) & 1) ? 1 : -1) : 0;
            mirror_step(&m, ((seed >> 19) & 15) == 0 ? PK_MIRROR_PRESS : 0, ax, dr,
                        ((seed >> 23) & 7) != 0, t += (seed >> 24) & 31, &mo);
            uint16_t w = exp_word(&mo, 1, 1);
            if ((w & EXP_MIR_EN2) && (w & EXP_MIR_EN3)) ok = false;                 /* one head */
            if (((w & (EXP_MIR_EN2 | EXP_MIR_EN3)) != 0) != ((w & EXP_MIR_EN1) != 0)) ok = false;
            if ((w & EXP_MIR_EN1) && (w & EXP_MIR_EN2) && !((w ^ (w >> 2)) & EXP_MIR_IN1)) ok = false;
            if ((w & EXP_MIR_EN1) && (w & EXP_MIR_EN3) && !((w ^ (w >> 4)) & EXP_MIR_IN1)) ok = false;
            if (w & (EXP_CAN_STB | EXP_INPUTS | EXP_WIN_DEN | EXP_WIN_DSEL0 | EXP_WIN_DSEL1 | EXP_MH_DEN)) ok = false;
        }
        CHECK(ok, "100k mirror steps: one head, always against the common, STB / DEN / inputs never driven");
    }

    /* ================= 16. reset: boot and the DRV8962's fault clear ================= */
    {
        exp_model_fresh();
        tca9539_t x; memset(&x, 0, sizeof x);
        CHECK(exp_reset_init(&x) == 1 && x.ok == 1 && g_exp.resets == 1, "boot: one reset pulse, acknowledged");
        CHECK(g_exp.regs_written.size() == 3 && g_exp.regs_written[0] == TCA_REG_OUTPUT0
              && g_exp.regs_written[1] == TCA_REG_POLARITY0 && g_exp.regs_written[2] == TCA_REG_CONFIG0,
              "outputs written low BEFORE the directions (they reset to 0xFF)");
        CHECK(g_exp.out == 0 && g_exp.cfg == EXP_INPUTS && g_exp.pol == 0 && g_exp.reads == 1,
              "after init: outputs low, two inputs, plain polarity, INT cleared by a read");
        bool quiet = true;
        for (uint16_t p : g_exp.pins)
            if (p & (EXP_MIR_NSLEEP | EXP_MIR_EN1 | EXP_MIR_EN2 | EXP_MIR_EN3 | EXP_MIR_EN4 | EXP_CAN_STB)) quiet = false;
        CHECK(quiet, "no EN, nSLEEP or STB pin goes high at any point of the reset or the init");

        /* writes: only on a change, a live rail change in two */
        g_exp.regs_written.clear();
        CHECK(exp_write_outputs(&x, EXP_MIR_NSLEEP | EXP_MIR_EN1) && g_exp.regs_written.size() == 1, "one write for a change");
        CHECK(exp_write_outputs(&x, EXP_MIR_NSLEEP | EXP_MIR_EN1) && g_exp.regs_written.size() == 1, "none for no change");
        g_exp.pins.clear();
        exp_write_outputs(&x, EXP_MIR_NSLEEP | EXP_MIR_EN1 | EXP_MIR_IN1);
        CHECK(g_exp.pins.size() == 2 && !(g_exp.pins[0] & EXP_MIR_EN1) && (g_exp.pins[1] & EXP_MIR_IN1),
              "a live bridge changing rail is opened in a write of its own");

        /* INT: the inputs are read back; nFAULT low is seen */
        g_exp.in = (uint16_t)(0xFFFF & ~EXP_MIR_NFAULT);
        CHECK(tca_read_inputs(&x) && !(x.in & EXP_MIR_NFAULT) && (x.in & EXP_PG_5V), "INT read: nFAULT low, power good");

        /* a silent expander: not ok, and its writes fail */
        g_exp.nack = true;
        CHECK(exp_write_outputs(&x, 0) == 0 && x.ok == 0, "no acknowledge: the driver knows");
        CHECK(exp_reset_init(&x) == 0, "and a re-init fails until it answers");
        g_exp.nack = false;
        CHECK(exp_reset_init(&x) == 1 && g_exp.out == 0, "answers again: re-initialised, all low");

        /* the guard: wake, fault, rest, clear through the reset */
        drv_guard_t g; memset(&g, 0, sizeof g); uint32_t t = 100000;
        drv_guard_step(&g, 0, 1, 1, t);
        CHECK(g.awake == 1 && drv_live(&g, t) == 0, "permitted: nSLEEP high, not live until it has woken");
        CHECK(drv_live(&g, t + DRV_WAKE_MS) == 1, "live after the wake time");
        drv_guard_step(&g, 1, 1, 0, t + 1);
        CHECK(g.fault == 0, "nFAULT while waking is not believed");
        t += 100;
        drv_guard_step(&g, 1, 1, 0, t);
        CHECK(g.fault == 1 && drv_live(&g, t) == 0, "nFAULT awake: latched, every bridge open");
        CHECK(drv_guard_step(&g, 1, 1, 0, t + DRV_FAULT_REST_MS) == DRV_NONE, "stick still held: no clear");
        CHECK(drv_guard_step(&g, 1, 1, 1, t + DRV_FAULT_REST_MS - 1) == DRV_NONE, "let go, but inside the rest: no clear");
        CHECK(drv_guard_step(&g, 1, 1, 1, t + DRV_FAULT_REST_MS) == DRV_CLEAR && g.clears == 1 && g.awake == 0,
              "rested and let go: cleared, asleep through the reset");

        /* the host's clear is the boot path: one more reset pulse, nSLEEP low through it */
        int r0 = g_exp.resets; g_exp.pins.clear();
        exp_reset_init(&x);
        bool slept = !g_exp.pins.empty();
        for (uint16_t p : g_exp.pins) if (p & EXP_MIR_NSLEEP) slept = false;
        CHECK(g_exp.resets == r0 + 1 && slept, "the clear pulses RESET and holds nSLEEP low (R35)");

        t += DRV_FAULT_REST_MS + 10;
        drv_guard_step(&g, 0, 1, 1, t);
        CHECK(g.awake == 1 && drv_live(&g, t + DRV_WAKE_MS) == 1, "woken again, live");
        for (int k = 0; k < DRV_FAULT_MAX_CLEARS + 2; k++) {        /* a hard short: it comes back */
            t += 100; drv_guard_step(&g, 1, 1, 1, t);
            t += DRV_FAULT_REST_MS; drv_guard_step(&g, 1, 1, 1, t);
            t += 10; drv_guard_step(&g, 0, 1, 1, t);
        }
        CHECK(g.clears == DRV_FAULT_MAX_CLEARS && g.fault == 1 && g.awake == 0 && drv_live(&g, t) == 0,
              "after three clears it gives up: asleep, mirrors off");
        drv_guard_step(&g, 1, 0, 1, t + 5);
        CHECK(g.clears == 0 && g.fault == 0 && g.awake == 0, "key cycled: tries refilled, asleep");
        drv_guard_step(&g, 0, 1, 1, t + 10);
        CHECK(g.awake == 1, "and wakes on the next permit");
    }

    /* ================= 17. CAN STB held low (SN26, D-452) ================= */
    {
        exp_model_fresh();
        tca9539_t x; memset(&x, 0, sizeof x);
        exp_hal_reset(1);
        CHECK(!(exp_pin_levels() & EXP_CAN_STB), "in reset STB sits on its pull-down: normal mode");
        exp_reset_init(&x);
        CHECK(!(g_exp.cfg & EXP_CAN_STB) && !(g_exp.out & EXP_CAN_STB), "after init STB is an output, driven low");
        bool low = true; uint32_t seed = 31337;
        for (int i = 0; i < 20000 && low; i++) {
            seed = seed * 1103515245u + 12345u;
            exp_write_outputs(&x, (uint16_t)(seed >> 8));           /* any word at all, STB bit included */
            if (exp_pin_levels() & EXP_CAN_STB) low = false;
            if (g_exp.cfg != EXP_INPUTS) low = false;
        }
        CHECK(low, "20k arbitrary output words: STB never leaves low, no port changes direction");
        mirror_out_t mo; memset(&mo, 0, sizeof mo);
        CHECK(!(exp_word(&mo, 0, 0) & EXP_CAN_STB) && !(exp_word(&mo, 1, 1) & EXP_CAN_STB),
              "asleep or awake, the DCU's word keeps STB low");
    }

    /* ================= 18. the logic rows' DCU terms (Y8, logic_vectors.h) =================
     * Three PMU logic rows read a term only the DCU's 0x400 frame can raise: MOTOR_BUS's
     * window_req (any of the four window keys), DEFOG's panel_defog (the defog key, D-350)
     * and ACCESSORY's release_pulse (raised by the hatch or fuel-door release, D-354). For
     * every generated vector that assigns one of them, the real key path (debounce, wake,
     * release select, 0x400 sender) is driven and the frame must carry the term exactly
     * when the vector says - every key of the term raises it, no other key does. The rows
     * themselves are the PMU's: test_suite section 14 holds the simulator to them. */
    {
        struct { const char *term; uint16_t keys; } dcuTerm[] = {
            { "window_req",    PK_WIN_DRV_UP | PK_WIN_DRV_DN | PK_WIN_PASS_UP | PK_WIN_PASS_DN },
            { "panel_defog",   PK_DEFOG },
            { "release_pulse", PK_HATCH | PK_FUEL_DOOR },
        };
        const int NT = (int)(sizeof dcuTerm / sizeof dcuTerm[0]);
        auto frame_down = [](uint16_t raw) -> uint16_t {
            panel_t p; memset(&p, 0, sizeof p);
            p.stopped = 1;                 /* a release only with the car stopped (D-465, section 8) */
            keys_tx_t tx; memset(&tx, 0, sizeof tx);
            panel_keys_t f; memset(&f, 0, sizeof f);
            uint16_t down = 0, held = 0; uint32_t t = 1000;
            for (int i = 0; i < 10; i++, t += 5) panel_keys_step(&p, raw, 1, t, &down, &held);
            panel_frame_due(&tx, down, held, 0, 100, t, &f);
            return f.down;
        };
        for (int d = 0; d < NT; d++) {
            bool named = false;
            for (int k = 0; k < LV_TERMS; k++) if (!strcmp(LV_TERM[k], dcuTerm[d].term)) named = true;
            char m[96]; snprintf(m, sizeof m, "the record's logic rows still read %s", dcuTerm[d].term);
            CHECK(named, m);
        }
        int pairs = 0;
        for (int v = 0; v < LV_VECTORS; v++) {
            const lv_vector_t &V = LV_VECTOR[v];
            for (int j = 0; j < LV_MAXV && V.term[j] >= 0; j++)
                for (int d = 0; d < NT; d++) {
                    if (strcmp(LV_TERM[V.term[j]], dcuTerm[d].term)) continue;
                    const uint16_t set = dcuTerm[d].keys;
                    bool ok = true;
                    if (V.tval[j]) {
                        for (int b = 0; b < PK_COUNT; b++)
                            if ((set & (1u << b)) && !(frame_down((uint16_t)(1u << b)) & set)) ok = false;
                    } else {
                        if (frame_down(0) & set) ok = false;
                        for (int b = 0; b < PK_COUNT; b++)
                            if (!(set & (1u << b)) && (frame_down((uint16_t)(1u << b)) & set)) ok = false;
                    }
                    char m[128];
                    snprintf(m, sizeof m, "%s vector %d: 0x400 carries %s = %d", LV_ROW[V.row].id, v,
                             dcuTerm[d].term, V.tval[j]);
                    CHECK(ok, m);
                    pairs++;
                }
        }
        CHECK(pairs > 0, "the logic vectors exercise at least one DCU term");
        printf("   logic vectors: %d DCU term assignments checked against the 0x400 key path\n", pairs);
    }

    /* ================= 19. the centre knob's modes (I-001, D-492) ================= */
    {
        dcu_state_t s = fresh(); knob_t k; memset(&k, 0, sizeof k);
        uint32_t t = 200000;
        panel_apply(&s, &k, 0, 2, 0, 0, t);
        CHECK(k.mode == KNOB_TEMP && s.mem.target_c == 23 && s.mem.blower == 0, "by default the knob sets the temperature");
        panel_apply(&s, &k, PK_CENTRE_PUSH, 0, 0, 0, t += 10);
        CHECK(k.mode == KNOB_FAN, "a push: the knob sets the fan speed");
        panel_apply(&s, &k, 0, 2, 0, 0, t += 1000);
        CHECK(s.mem.blower == 2 && s.mem.target_c == 23, "turned: fan 2, the temperature untouched");
        panel_apply(&s, &k, 0, 0, 0, 0, t += KNOB_REST_MS - 1);
        CHECK(k.mode == KNOB_FAN, "1 ms short of the rest: still the fan");
        panel_apply(&s, &k, 0, 0, 0, 0, t += 1);
        CHECK(k.mode == KNOB_TEMP, "rested 3 s: back to the temperature");
        panel_apply(&s, &k, 0, -1, 0, 0, t += 5);
        CHECK(s.mem.target_c == 22 && s.mem.blower == 2, "and a detent sets the temperature again, the fan kept");

        panel_apply(&s, &k, PK_CENTRE_PUSH, 0, 0, 0, t += 10);
        for (int i = 0; i < 5; i++) panel_apply(&s, &k, 0, (i & 1) ? -1 : 1, 0, 0, t += KNOB_REST_MS - 100);
        CHECK(k.mode == KNOB_FAN && s.mem.blower == 3, "kept turning: still the fan - each detent restarts the rest");
        panel_apply(&s, &k, PK_CENTRE_PUSH, 1, 0, 0, t += 10);
        CHECK(k.mode == KNOB_TEMP && s.mem.target_c == 23 && s.mem.blower == 3,
              "a second push in fan: straight back to the temperature, the detent with it sets the temperature");
        panel_apply(&s, &k, PK_CENTRE_PUSH, 0, 0, 0, t += 10);
        panel_apply(&s, &k, 0, 0, 0, 0, t += KNOB_REST_MS);
        CHECK(k.mode == KNOB_TEMP && s.mem.blower == 3, "a push not followed by a turn: back to the temperature after the rest");

        s.mem.mode = CLIM_VENT;
        panel_apply(&s, &k, PK_FAN_MODE, 0, 0, 0, t += 10);
        CHECK(k.mode == KNOB_MODE && s.mem.mode == CLIM_VENT, "the fan-mode key: the knob sets the mode; the press itself changes nothing");
        panel_apply(&s, &k, 0, 1, 0, 0, t += 10);
        CHECK(s.mem.mode == CLIM_HEAT && s.mem.target_c == 23 && s.mem.blower == 3, "one detent: VENT -> HEAT, nothing else moves");
        panel_apply(&s, &k, 0, 2, 0, 0, t += 10);
        CHECK(s.mem.mode == CLIM_VENT, "two more: DEFROST and round to VENT - no end stop");
        panel_apply(&s, &k, 0, -1, 0, 0, t += 10);
        CHECK(s.mem.mode == CLIM_DEFROST && s.mem.cal[SRV_MODE].us_now == 2000,
              "anticlockwise from VENT wraps to DEFROST; the mode door follows");
        panel_apply(&s, &k, PK_FAN_MODE, 0, 0, 0, t += 10);
        CHECK(k.mode == KNOB_TEMP, "a second fan-mode press: straight back to the temperature");
        panel_apply(&s, &k, PK_FAN_MODE, 0, 0, 0, t += 10);
        panel_apply(&s, &k, 0, 0, 0, 0, t += KNOB_REST_MS - 1);
        CHECK(k.mode == KNOB_MODE, "the mode left alone: still the mode 1 ms short of the rest");
        panel_apply(&s, &k, 0, 0, 0, 0, t += 1);
        CHECK(k.mode == KNOB_TEMP && s.mem.mode == CLIM_DEFROST, "rested: back to the temperature, the mode kept");

        panel_apply(&s, &k, PK_FAN_MODE, 0, 0, 0, t += 10);
        panel_apply(&s, &k, PK_CENTRE_PUSH, 0, 0, 0, t += 10);
        CHECK(k.mode == KNOB_FAN, "a push while setting the mode: the fan");
        panel_apply(&s, &k, PK_FAN_MODE, 0, 0, 0, t += 10);
        CHECK(k.mode == KNOB_MODE, "the fan-mode key while setting the fan: the mode");
        panel_apply(&s, &k, PK_FAN_MODE, 0, 0, 0, t += 10);

        panel_apply(&s, &k, 0, 50, 0, 0, t += 10);
        CHECK(s.mem.target_c == TEMP_MAX_C, "the knob turns on; the temperature stops at 30");
        panel_apply(&s, &k, 0, -50, 0, 0, t += 10);
        CHECK(s.mem.target_c == TEMP_MIN_C, "and at 16");
        s.mem.mode = CLIM_OFF;
        panel_apply(&s, &k, PK_FAN_MODE, -1, 0, 0, t += 10);
        CHECK(s.mem.mode == CLIM_VENT, "from OFF (or a corrupt mode) the first detent lands on VENT");
        CHECK(mode_turn(CLIM_AC, 1) == CLIM_VENT && mode_turn(CLIM_HEAT, -1) == CLIM_VENT && mode_turn(CLIM_DEFROST, 1) == CLIM_VENT,
              "mode_turn: A/C never reached, the cycle wraps");

        /* random presses and turns: the settings stay in range, the knob is never
         * off the temperature once it has rested KNOB_REST_MS */
        bool ok = true; uint32_t seed = 2468, last_ev = t;
        s = fresh(); memset(&k, 0, sizeof k);
        for (int i = 0; i < 100000 && ok; i++) {
            seed = seed * 1103515245u + 12345u;
            uint16_t pr = 0;
            if (((seed >> 16) & 31) == 0) pr |= PK_CENTRE_PUSH;
            if (((seed >> 21) & 31) == 0) pr |= PK_FAN_MODE;
            int det = ((seed >> 26) & 3) == 0 ? (int)((seed >> 12) % 5) - 2 : 0;
            t += (seed >> 3) & 511;
            uint8_t before = k.mode;
            panel_apply(&s, &k, pr, det, 0, 0, t);
            if (s.mem.target_c < TEMP_MIN_C || s.mem.target_c > TEMP_MAX_C || s.mem.blower > FAN_LEVELS) ok = false;
            if (s.mem.mode < CLIM_VENT || s.mem.mode > CLIM_DEFROST) ok = false;
            if (!pr && (uint32_t)(t - last_ev) >= KNOB_REST_MS && k.mode != KNOB_TEMP) ok = false;
            if (!pr && !det && before == KNOB_TEMP && k.mode != KNOB_TEMP) ok = false;
            if (pr || det) last_ev = t;
        }
        CHECK(ok, "100k random presses and turns: in range, and home to the temperature after every rest");
    }

    /* ================= 20. the seat knobs (I-003, D-492, D-073) ================= */
    {
        dcu_state_t s = fresh(); knob_t k; memset(&k, 0, sizeof k);
        uint32_t t = 250000;
        CHECK(seat_pos(&s.mem, 0) == 0 && seat_pos(&s.mem, 2) == 0, "both seats start OFF, the middle");
        panel_apply(&s, &k, 0, 0, 1, 0, t);
        CHECK(seat_pos(&s.mem, 0) == 1 && s.comfort_on[CMF_SEAT_HEAT_DRV] && !s.comfort_on[CMF_SEAT_COOL_DRV],
              "one click clockwise: heat 1");
        panel_apply(&s, &k, 0, 0, -1, 0, t += 10);
        CHECK(seat_pos(&s.mem, 0) == 0 && !s.comfort_on[CMF_SEAT_HEAT_DRV] && !s.comfort_on[CMF_SEAT_COOL_DRV],
              "one back: OFF - heat and cool both off in the middle");
        panel_apply(&s, &k, 0, 0, -1, 0, t += 10);
        CHECK(seat_pos(&s.mem, 0) == -1 && s.comfort_on[CMF_SEAT_COOL_DRV] && !s.comfort_on[CMF_SEAT_HEAT_DRV],
              "one anticlockwise from OFF: cool 1");
        panel_apply(&s, &k, 0, 0, 10, 0, t += 10);
        CHECK(seat_pos(&s.mem, 0) == SEAT_STEPS, "ten clicks clockwise: clamped at heat 3");
        panel_apply(&s, &k, 0, 0, -1, 0, t += 10);
        CHECK(seat_pos(&s.mem, 0) == 2, "one back from the clamp: heat 2 - turns past the end are not stored");
        panel_apply(&s, &k, 0, 0, 0, -10, t += 10);
        CHECK(seat_pos(&s.mem, 2) == -SEAT_STEPS && seat_pos(&s.mem, 0) == 2, "passenger clamped at cool 3, the driver untouched");
        panel_apply(&s, &k, 0, 0, 0, 0, t += 60000);
        panel_apply(&s, &k, PK_CENTRE_PUSH | PK_FAN_MODE, 3, 0, 0, t += 60000);
        CHECK(seat_pos(&s.mem, 0) == 2 && seat_pos(&s.mem, 2) == -3, "the positions persist while the knobs rest, whatever the centre knob does");
        bool ok = true;
        for (int a = -5; a <= 5; a++) {
            dcu_state_t q = fresh();
            panel_apply(&q, &k, 0, 0, a, 0, t);
            int want = a > 3 ? 3 : (a < -3 ? -3 : a);
            if (seat_pos(&q.mem, 0) != want) ok = false;
            if ((q.mem.seat_heat & 3) && (q.mem.seat_cool & 3)) ok = false;
        }
        CHECK(ok, "every turn from OFF lands on its clamped position, never heat and cool together");
    }

    /* ================= 21. the mirror select (I-002, D-492) ================= */
    {
        mirror_t m; memset(&m, 0, sizeof m); mirror_out_t o; uint32_t t = 300000;
        mirror_step(&m, 0, AXIS_X, 1, 1, t, &o);
        CHECK(m.side == MIRROR_LEFT && o.left != HB_OFF && o.right == HB_OFF, "the stick moves the left mirror by default");
        mirror_step(&m, 0, AXIS_NONE, 0, 1, t += 5, &o);
        mirror_step(&m, PK_MIRROR_PRESS, AXIS_NONE, 0, 1, t += 5, &o);
        CHECK(m.side == MIRROR_RIGHT && o.left == HB_OFF && o.right == HB_OFF, "a push: the right is selected, nothing moves");
        mirror_step(&m, 0, AXIS_Y, 1, 1, t += MIRROR_DEAD_MS, &o);
        CHECK(o.right != HB_OFF && o.left == HB_OFF, "the stick now moves the right mirror");
        for (int i = 0; i < 80; i++) mirror_step(&m, 0, AXIS_Y, 1, 1, t += 100, &o);   /* 8 s of moving */
        CHECK(m.side == MIRROR_RIGHT, "moving longer than 3 s: still the right (movement restarts the rest)");
        uint32_t last_move = t;
        mirror_step(&m, 0, AXIS_NONE, 0, 1, t += 5, &o);
        mirror_step(&m, 0, AXIS_NONE, 0, 1, t = last_move + MIRROR_RIGHT_REST_MS - 1, &o);
        CHECK(m.side == MIRROR_RIGHT, "at rest 1 ms short of 3 s: still the right");
        mirror_step(&m, 0, AXIS_NONE, 0, 1, t = last_move + MIRROR_RIGHT_REST_MS, &o);
        CHECK(m.side == MIRROR_LEFT, "3 s at rest: back to the left by itself");
        mirror_step(&m, 0, AXIS_X, -1, 1, t += MIRROR_DEAD_MS, &o);
        CHECK(o.left != HB_OFF && o.right == HB_OFF, "and the stick moves the left again");

        mirror_step(&m, 0, AXIS_NONE, 0, 1, t += 5, &o);
        mirror_step(&m, PK_MIRROR_PRESS, AXIS_NONE, 0, 1, t += 5, &o);
        mirror_step(&m, 0, AXIS_NONE, 0, 1, t += 1000, &o);
        CHECK(m.side == MIRROR_RIGHT, "pushed, not moved: the right for now");
        mirror_step(&m, PK_MIRROR_PRESS, AXIS_NONE, 0, 1, t += 5, &o);
        CHECK(m.side == MIRROR_LEFT, "a second push: straight back to the left");
        mirror_step(&m, PK_MIRROR_PRESS, AXIS_NONE, 0, 1, t += 5, &o);
        uint32_t t_push = t;
        mirror_step(&m, 0, AXIS_NONE, 0, 1, t = t_push + MIRROR_RIGHT_REST_MS - 1, &o);
        CHECK(m.side == MIRROR_RIGHT, "pushed and never moved: the right until 3 s");
        mirror_step(&m, 0, AXIS_NONE, 0, 1, t = t_push + MIRROR_RIGHT_REST_MS, &o);
        CHECK(m.side == MIRROR_LEFT, "then the left");

        mirror_step(&m, PK_MIRROR_PRESS, AXIS_X, 1, 1, t += 5, &o);
        mirror_step(&m, 0, AXIS_X, 1, 1, t += MIRROR_DEAD_MS, &o);
        CHECK(o.right != HB_OFF, "right, moving");
        mirror_step(&m, PK_MIRROR_PRESS, AXIS_X, 1, 1, t += 5, &o);
        CHECK(m.side == MIRROR_LEFT && o.left == HB_OFF && o.right == HB_OFF, "a second push mid-move: left, and everything stops first");

        /* random: the right is selected only within 3 s of a push or a movement */
        bool ok = true; uint32_t seed = 13579, last_ev = t;
        memset(&m, 0, sizeof m);
        for (int i = 0; i < 100000 && ok; i++) {
            seed = seed * 1103515245u + 12345u;
            uint8_t ax = ((seed >> 16) & 7) == 0 ? (uint8_t)(1 + ((seed >> 19) & 1)) : AXIS_NONE;
            int8_t dr = ax ? (((seed >> 20) & 1) ? 1 : -1) : 0;
            uint16_t pr = ((seed >> 22) & 63) == 0 ? PK_MIRROR_PRESS : 0;
            t += (seed >> 4) & 1023;
            mirror_step(&m, pr, ax, dr, ((seed >> 28) & 3) != 0, t, &o);
            if (pr || ax) last_ev = t;
            if (m.side == MIRROR_RIGHT && (uint32_t)(t - last_ev) >= MIRROR_RIGHT_REST_MS) ok = false;
            if (o.left != HB_OFF && o.right != HB_OFF) ok = false;
        }
        CHECK(ok, "100k random steps: the right only within 3 s of a push or a movement, one head at a time");
    }

    /* ================= 22. the mirror-defog key (D-492; D-442 had it follow the rear defogger) ================= */
    {
        dcu_state_t s = fresh(); s.key_pos = KEY_RUN; s.pmu_alive = 1;
        mirror_defog_t d; memset(&d, 0, sizeof d); uint32_t t = 400000;
        mirror_defog_step(&d, &s, 0, t);
        CHECK(d.on == 0 && s.comfort_on[CMF_MIRROR_HEAT] == 0, "off by default");
        mirror_defog_step(&d, &s, PK_MIRROR_DEFOG, t += 10);
        CHECK(d.on == 1 && s.comfort_on[CMF_MIRROR_HEAT] == 1, "its key: mirror heat on");
        mirror_defog_step(&d, &s, PK_DEFOG, t += 10);
        CHECK(d.on == 1, "the rear-defog key does not touch it");
        mirror_defog_step(&d, &s, PK_MIRROR_DEFOG, t += 10);
        CHECK(d.on == 0 && s.comfort_on[CMF_MIRROR_HEAT] == 0, "pressed again: off");
        mirror_defog_step(&d, &s, PK_DEFOG, t += 10);
        CHECK(d.on == 0, "the rear defogger switched on: the mirrors stay off (they no longer follow it)");

        s.key_pos = KEY_ACC;
        mirror_defog_step(&d, &s, PK_MIRROR_DEFOG, t += 10);
        CHECK(d.on == 0, "pressed in ACC: refused, the key stays dark");
        s.key_pos = KEY_RUN;
        mirror_defog_step(&d, &s, PK_MIRROR_DEFOG, t += 10);
        s.pmu_alive = 0;
        mirror_defog_step(&d, &s, 0, t += 10);
        CHECK(d.on == 0 && s.comfort_on[CMF_MIRROR_HEAT] == 0, "the PMU lost: off");
        s.pmu_alive = 1;
        mirror_defog_step(&d, &s, 0, t += 10);
        CHECK(d.on == 0, "and stays off when it comes back");
        mirror_defog_step(&d, &s, PK_MIRROR_DEFOG, t += 10);
        mirror_defog_step(&d, &s, 0, t += MIRROR_DEFOG_MAX_MS - 11);
        CHECK(d.on == 1, "on, short of the timer");
        mirror_defog_step(&d, &s, 0, t += 11);
        CHECK(d.on == 0, "off after MIRROR_DEFOG_MAX_MS");

        /* through the key path: two bits, never the same edge */
        panel_t p; memset(&p, 0, sizeof p); uint16_t down = 0, held = 0;
        for (int i = 0; i < 6; i++, t += 5) panel_keys_step(&p, PK_MIRROR_DEFOG, 1, t, &down, &held);
        CHECK(down == PK_MIRROR_DEFOG && !(down & PK_DEFOG), "0x400: mirror defog is b10, the rear defog b0 stays clear");
    }

    /* ================= 23. the window switches as paired contacts (I-002, D-492, D-363) ================= */
    {
        CHECK(window_pairs(PK_WIN_DRV_UP) == PK_WIN_DRV_UP && window_pairs(PK_WIN_PASS_DN) == PK_WIN_PASS_DN,
              "one contact: that direction");
        CHECK(window_pairs(PK_WIN_DRV_UP | PK_WIN_DRV_DN) == 0, "both contacts of one switch: neither");
        CHECK(window_pairs(PK_WIN_DRV_UP | PK_WIN_DRV_DN | PK_WIN_PASS_UP | PK_RECIRC) == (PK_WIN_PASS_UP | PK_RECIRC),
              "the other side and the other keys untouched");
        CHECK(window_pairs(PK_WIN_DRV_UP | PK_WIN_PASS_DN) == (PK_WIN_DRV_UP | PK_WIN_PASS_DN), "one contact a side: both kept");

        panel_t p; memset(&p, 0, sizeof p); uint16_t down = 0, held = 0; uint32_t t = 500000;
        for (int i = 0; i < 250; i++, t += 5) panel_keys_step(&p, PK_WIN_DRV_UP | PK_WIN_DRV_DN, 1, t, &down, &held);
        CHECK(!(down & PK_WIN_DRV) && !(held & PK_WIN_DRV), "both held 1.25 s: 0x400 carries neither, nor held");
        window_t w; memset(&w, 0, sizeof w); uint8_t up, dn;
        window_step(&w, (down & PK_WIN_DRV_UP) != 0, (down & PK_WIN_DRV_DN) != 0, 1, t, &up, &dn);
        CHECK(up == 0 && dn == 0, "and the window does not move");
        for (int i = 0; i < 10; i++, t += 5) panel_keys_step(&p, PK_WIN_DRV_UP, 1, t, &down, &held);
        CHECK((down & PK_WIN_DRV) == PK_WIN_DRV_UP, "the down contact opens: up alone");

        bool ok = true; uint32_t seed = 8642;
        memset(&p, 0, sizeof p);
        for (int i = 0; i < 100000 && ok; i++, t += 5) {
            seed = seed * 1103515245u + 12345u;
            uint16_t raw = (uint16_t)((seed >> 12) & (PK_WIN_DRV | PK_WIN_PASS));
            panel_keys_step(&p, raw, 1, t, &down, &held);
            if ((down & PK_WIN_DRV) == PK_WIN_DRV || (down & PK_WIN_PASS) == PK_WIN_PASS) ok = false;
        }
        CHECK(ok, "100k random contact patterns: 0x400 never carries both contacts of one switch");
    }

    /* ================= 24. the lights (lights.h; D-458, D-492, I-004, I-005) ================= */
    {
        lights_in_t in; memset(&in, 0, sizeof in); lights_out_t o;
        in.pmu_alive = 1; in.key_pos = KEY_RUN; in.headlight = HL_OFF;
        in.dash_pct = DASH_PCT_MAX;            /* the dash at full: the backlight is LIGHT_BACK (section 26 dims it) */
        lights_step(&in, &o);
        bool dark = true;
        for (int i = 0; i < LED_PANEL_CH; i++) if (o.panel[i]) dark = false;
        for (int i = 0; i < LED_PLATE_CH; i++) if (o.plate[i]) dark = false;
        CHECK(dark, "lights off, nothing on, seats OFF: every LED dark");

        in.headlight = HL_PARK; lights_step(&in, &o);
        bool ring = true;
        for (int i = 0; i < LP_RING_N; i++) if (o.panel[LP_RING0 + i] != LIGHT_BACK) ring = false;
        CHECK(ring && o.panel[LP_WIN_DRV] == LIGHT_BACK && o.panel[LP_WIN_PASS] == LIGHT_BACK
              && o.panel[LP_SEAT_DRV_SYM] == LIGHT_BACK && o.panel[LP_SEAT_PASS_SYM] == LIGHT_BACK,
              "park lamps: the ring, the window and seat symbols at the backlight level");
        CHECK(o.panel[LP_DEFOG] == LIGHT_BACK && o.panel[LP_MIRROR_DEFOG] == LIGHT_BACK && o.panel[LP_RECIRC] == LIGHT_BACK
              && o.panel[LP_FAN_MODE] == LIGHT_BACK, "the four key symbols dimmed when their function is off");
        bool plate = true;
        const int QS[] = { LQ_WINK_L, LQ_WINK_R, LQ_HATCH, LQ_FUEL_DOOR, LQ_MIRROR, LQ_HAZARD };
        for (int q : QS) if (o.plate[q] != LIGHT_BACK) plate = false;
        for (int i = 0; i < LQ_USED; i++) {
            bool named = false;
            for (int q : QS) if (q == i) named = true;
            if (!named && o.plate[i]) plate = false;
        }
        CHECK(plate, "the plate's six symbols follow the lights, its unused outputs dark (Y62: OUT6 hazard, OUT13 mirror)");
        in.hazard = 1; lights_step(&in, &o);
        CHECK(o.plate[LQ_HAZARD] == LIGHT_FULL && o.plate[LQ_MIRROR] == LIGHT_BACK, "the hazard's triangle full while A8 reads HAZARD (D-589)");
        in.hazard = 0; lights_step(&in, &o);
        in.headlight = HL_HEAD; lights_step(&in, &o);
        CHECK(o.panel[LP_RING0] == LIGHT_BACK && o.plate[LQ_MIRROR] == LIGHT_BACK, "head lamps: the same");
        in.pmu_alive = 0; lights_step(&in, &o);
        CHECK(o.panel[LP_RING0] == 0 && o.plate[LQ_MIRROR] == 0, "0x100 stale: dark, the last headlight state not held");

        in.pmu_alive = 1; in.headlight = HL_OFF; in.recirc = 1; lights_step(&in, &o);
        CHECK(o.panel[LP_RECIRC] == LIGHT_FULL && o.panel[LP_RING0] == 0 && o.panel[LP_DEFOG] == 0,
              "lights off, recirculate on: its symbol at full, nothing else");
        in.headlight = HL_HEAD; lights_step(&in, &o);
        CHECK(o.panel[LP_RECIRC] == LIGHT_FULL, "with the lights on a key that is on stays at full");
        in.recirc = 0; in.headlight = HL_OFF; in.rear_defog = 1; lights_step(&in, &o);
        CHECK(o.panel[LP_DEFOG] == LIGHT_FULL && o.panel[LP_MIRROR_DEFOG] == 0, "rear defog on (O4): its symbol, not the mirror's");
        in.rear_defog = 0; in.mirror_defog = 1; lights_step(&in, &o);
        CHECK(o.panel[LP_MIRROR_DEFOG] == LIGHT_FULL && o.panel[LP_DEFOG] == 0, "mirror defog on: its own symbol");
        in.mirror_defog = 0; in.fan_mode_active = 1; lights_step(&in, &o);
        CHECK(o.panel[LP_FAN_MODE] == LIGHT_FULL, "the fan-mode key lit while the knob sets the mode");
        in.fan_mode_active = 0;

        in.seat_drv = 2; in.seat_pass = -3; lights_step(&in, &o);
        CHECK(o.panel[LP_ARC_DRV0 + 3] == LIGHT_FULL && o.panel[LP_ARC_DRV0 + 4] == LIGHT_FULL && o.panel[LP_ARC_DRV0 + 5] == 0
              && o.panel[LP_ARC_DRV0 + 0] == 0 && o.panel[LP_ARC_DRV0 + 2] == 0,
              "driver heat 2, lights off: OUT27-28 (heat 1, 2) at full, cool dark");
        CHECK(o.panel[LP_ARC_PASS0 + 0] == LIGHT_FULL && o.panel[LP_ARC_PASS0 + 1] == LIGHT_FULL && o.panel[LP_ARC_PASS0 + 2] == LIGHT_FULL
              && o.panel[LP_ARC_PASS0 + 3] == 0, "passenger cool 3: OUT30-32 at full, heat dark");
        CHECK(o.panel[LP_SEAT_DRV_SYM] == 0, "the seat symbol still waits for the lights");
        in.key_pos = KEY_OFF; in.headlight = HL_PARK; in.recirc = 1; lights_step(&in, &o);
        CHECK(o.panel[LP_ARC_DRV0 + 3] == 0 && o.panel[LP_RECIRC] == LIGHT_BACK && o.panel[LP_RING0] == LIGHT_BACK,
              "key out, park lamps on: the backlights glow, the state lights do not (confirm)");
        in.key_pos = KEY_RUN; in.recirc = 0; in.seat_drv = in.seat_pass = 0;
        in.wink_l = 1; lights_step(&in, &o);
        CHECK(o.plate[LQ_WINK_L] == LIGHT_FULL && o.plate[LQ_WINK_R] == LIGHT_BACK, "a wink pressed (once F-009 exports it): its face at full");

        /* random inputs: the unused channels never light, every value is one of the three levels */
        bool used[LED_PANEL_CH] = { false };
        const int u[] = { LP_DEFOG, LP_MIRROR_DEFOG, LP_FAN_MODE, LP_RECIRC, LP_WIN_DRV, LP_WIN_PASS,
                          LP_SEAT_DRV_SYM, LP_SEAT_PASS_SYM };
        for (int i : u) used[i] = true;
        for (int i = 0; i < LP_RING_N; i++) used[LP_RING0 + i] = true;
        for (int i = 0; i < 6; i++) { used[LP_ARC_DRV0 + i] = true; used[LP_ARC_PASS0 + i] = true; }
        int n_used = 0; for (bool b : used) n_used += b;
        CHECK(n_used == 24, "24 panel channels in use (P192: about 24 LEDs)");
        bool ok = true; uint32_t seed = 97531;
        for (int i = 0; i < 50000 && ok; i++) {
            seed = seed * 1103515245u + 12345u;
            in.pmu_alive = (seed >> 8) & 1; in.key_pos = (uint8_t)((seed >> 9) % 5); in.headlight = (uint8_t)((seed >> 12) % 3);
            in.rear_defog = (seed >> 14) & 1; in.mirror_defog = (seed >> 15) & 1; in.recirc = (seed >> 16) & 1;
            in.fan_mode_active = (seed >> 17) & 1; in.seat_drv = (int8_t)((seed >> 18) % 7) - 3;
            in.seat_pass = (int8_t)((seed >> 21) % 7) - 3; in.wink_l = (seed >> 24) & 1; in.wink_r = (seed >> 25) & 1; in.hazard = (seed >> 26) & 1;
            lights_step(&in, &o);
            for (int c = 0; c < LED_PANEL_CH; c++) {
                if (!used[c] && o.panel[c]) ok = false;
                if (o.panel[c] != 0 && o.panel[c] != LIGHT_BACK && o.panel[c] != LIGHT_FULL) ok = false;
            }
            for (int c = 0; c < LED_PLATE_CH; c++)
                if (o.plate[c] && c != LQ_WINK_L && c != LQ_WINK_R && c != LQ_HATCH && c != LQ_FUEL_DOOR
                    && c != LQ_MIRROR && c != LQ_HAZARD) ok = false;
            for (int side = 0; side < 2; side++) {               /* heat and cool never lit together */
                const uint8_t *a = &o.panel[side ? LP_ARC_PASS0 : LP_ARC_DRV0];
                if ((a[0] | a[1] | a[2]) && (a[3] | a[4] | a[5])) ok = false;
            }
        }
        CHECK(ok, "50k random states: unused channels dark, three levels only, an arc never heat and cool at once");

        /* the register writes: init, a frame, nothing on no change, a silent driver retried */
        lights_t l; memset(&l, 0, sizeof l); g_led.clear(); g_led_nack_panel = false;
        CHECK(lights_init_panel(&l) == 1 && lights_init_plate(&l) == 1, "both drivers initialised");
        bool small = true;
        for (const LedWrite &w : g_led) if (w.bytes.size() > LIGHTS_CHUNK + 1u) small = false;
        CHECK(small, "every transaction fits Wire's buffer");
        const LedWrite *last_panel = nullptr;
        for (const LedWrite &w : g_led) if (w.addr == LED_PANEL_ADDR) last_panel = &w;
        CHECK(last_panel && last_panel->bytes[0] == IS3236_SHUTDOWN && last_panel->bytes[1] == 0x01,
              "the panel's driver leaves shutdown last, every PWM already 0");
        memset(&in, 0, sizeof in); in.pmu_alive = 1; in.key_pos = KEY_RUN; in.headlight = HL_HEAD; in.seat_drv = 1;
        lights_step(&in, &o);
        g_led.clear();
        CHECK(lights_write(&l, &o, 600000) == 2, "a new frame: written to both drivers");
        uint8_t img[LED_PANEL_CH]; memset(img, 0xEE, sizeof img); bool upd_last = false;
        for (const LedWrite &w : g_led) if (w.addr == LED_PANEL_ADDR) {
            if (w.bytes[0] >= IS3236_PWM1 && w.bytes[0] < IS3236_PWM1 + LED_PANEL_CH)
                for (size_t j = 1; j < w.bytes.size(); j++) img[w.bytes[0] - IS3236_PWM1 + j - 1] = w.bytes[j];
            upd_last = (w.bytes[0] == IS3236_UPDATE);
        }
        CHECK(!memcmp(img, o.panel, LED_PANEL_CH) && upd_last, "the panel's 36 PWM registers carry the frame, then the update latch");
        g_led.clear();
        CHECK(lights_write(&l, &o, 600010) == 0 && g_led.empty(), "the same frame again: nothing on the bus");
        in.recirc = 1; lights_step(&in, &o);
        g_led_nack_panel = true;
        lights_write(&l, &o, 600020);
        CHECK(l.ok_panel == 0 && l.ok_plate == 1, "the panel's driver silent: marked, the plate's unaffected");
        g_led_nack_panel = false;
        lights_write(&l, &o, 600030);
        CHECK(l.ok_panel == 0, "not retried inside LIGHTS_RETRY_MS");
        lights_write(&l, &o, 600020 + LIGHTS_RETRY_MS);
        CHECK(l.ok_panel == 1 && !memcmp(l.sent_panel, o.panel, LED_PANEL_CH), "re-initialised after the retry time, and the frame written");
    }

    /* ================= 25. the screen's pages (screen.h; I-001, I-004, D-492) ================= */
    {
        dcu_state_t s = fresh(); knob_t k; memset(&k, 0, sizeof k); screen_t sc;
        uint32_t t = 700000;
        s.mem.blower = 2;
        panel_apply(&s, &k, 0, 0, 0, 0, t);
        screen_build(&sc, &k, &s.mem, 12);
        CHECK(sc.page == SCR_REST && !strcmp(sc.temp, "21") && sc.fan_bars == 2 && sc.fan_of == 3
              && !strcmp(sc.mode, "VENT") && !strcmp(sc.outside, "12"),
              "rest: the set temperature, the fan bars, the mode word, the outside air");
        screen_build(&sc, &k, &s.mem, TEMP_INVALID);
        CHECK(!strcmp(sc.outside, "--"), "outside air blank: dashes, never a number");
        screen_build(&sc, &k, &s.mem, -7);
        CHECK(!strcmp(sc.outside, "-7"), "below zero");

        panel_apply(&s, &k, 0, 1, 0, 0, t += 10);
        screen_build(&sc, &k, &s.mem, 12);
        CHECK(sc.page == SCR_TEMP && !strcmp(sc.temp, "22") && sc.fan_bars == -1 && !sc.mode[0] && !sc.outside[0],
              "the temperature turned: it alone");
        panel_apply(&s, &k, 0, 0, 0, 0, t + SCREEN_REST_MS - 1);
        screen_build(&sc, &k, &s.mem, 12);
        CHECK(sc.page == SCR_TEMP, "still, 1 ms short of the rest");
        panel_apply(&s, &k, 0, 0, 0, 0, t += SCREEN_REST_MS);
        screen_build(&sc, &k, &s.mem, 12);
        CHECK(sc.page == SCR_REST, "3 s after the knob rests: back to rest");

        panel_apply(&s, &k, PK_CENTRE_PUSH, 0, 0, 0, t += 10);
        screen_build(&sc, &k, &s.mem, 12);
        CHECK(sc.page == SCR_FAN && sc.fan_bars == 2 && !sc.temp[0] && !sc.mode[0] && !sc.outside[0],
              "after a push: the fan bars alone, before any turn");
        panel_apply(&s, &k, 0, 1, 0, 0, t += 10);
        screen_build(&sc, &k, &s.mem, 12);
        CHECK(sc.page == SCR_FAN && sc.fan_bars == 3, "turned: the bars follow");
        panel_apply(&s, &k, PK_CENTRE_PUSH, 0, 0, 0, t += 10);
        screen_build(&sc, &k, &s.mem, 12);
        CHECK(sc.page == SCR_REST, "a second push: straight to rest");

        panel_apply(&s, &k, PK_FAN_MODE, 0, 0, 0, t += 10);
        screen_build(&sc, &k, &s.mem, 12);
        CHECK(sc.page == SCR_MODE && !strcmp(sc.mode, "VENT") && !sc.temp[0] && sc.fan_bars == -1 && !sc.outside[0],
              "the fan-mode key: the mode word alone");
        panel_apply(&s, &k, 0, 2, 0, 0, t += 10);
        screen_build(&sc, &k, &s.mem, 12);
        CHECK(!strcmp(sc.mode, "DEFROST"), "turned twice: DEFROST");
        panel_apply(&s, &k, 0, 0, 0, 0, t += KNOB_REST_MS);
        screen_build(&sc, &k, &s.mem, 12);
        CHECK(sc.page == SCR_REST && !strcmp(sc.mode, "DEFROST") && !strcmp(sc.temp, "22"), "rested: rest, with the new mode");
        CHECK(!strcmp(mode_word(CLIM_AC), "") && !strcmp(mode_word(CLIM_HEAT), "HEAT"),
              "no A/C mark, ever (I-004); recirculate has no field at all");

        bool ok = true; uint32_t seed = 11111;
        for (int i = 0; i < 50000 && ok; i++) {
            seed = seed * 1103515245u + 12345u;
            uint16_t pr = 0;
            if (((seed >> 16) & 15) == 0) pr |= PK_CENTRE_PUSH;
            if (((seed >> 20) & 15) == 0) pr |= PK_FAN_MODE;
            int det = ((seed >> 24) & 3) == 0 ? (int)((seed >> 12) % 3) - 1 : 0;
            panel_apply(&s, &k, pr, det, 0, 0, t += (seed >> 2) & 1023);
            screen_build(&sc, &k, &s.mem, (int8_t)((seed >> 5) % 120) - 40);
            int shown = (sc.temp[0] != 0) + (sc.fan_bars >= 0) + (sc.mode[0] != 0) + (sc.outside[0] != 0);
            if (sc.page == SCR_REST ? shown != 4 : shown != 1) ok = false;
            if (sc.page > SCR_MODE) ok = false;
        }
        CHECK(ok, "50k random scans: rest shows all four, an adjusting page exactly one");
    }

    /* ================= 26. the dash-light level (SN31, D-577, D-578) ================= */
    {
        climate_mem_t m; mem_defaults(&m);
        CHECK(m.dash_pct == DASH_PCT_MAX, "a fresh memory: the dash at full, as a reset leaves the stage");
        CHECK(dash_clamp(0) == DASH_PCT_MIN && dash_clamp(250) == DASH_PCT_MAX && dash_clamp(55) == 55,
              "the level is held to 10..100 - the knob cannot put the dash out");
        CHECK(dash_pwm(100) == 255 && dash_pwm(50) == 128 && dash_pwm(0) == dash_pwm(DASH_PCT_MIN) && dash_pwm(DASH_PCT_MIN) > 0,
              "the stage's PWM: 255 at full, half at 50 %, never below the minimum");
        CHECK(DASH_PWM_HZ == 200, "200 Hz (SN31)");
        CHECK(light_back(100) == LIGHT_BACK && light_back(50) == (LIGHT_BACK + 1) / 2 && light_back(DASH_PCT_MIN) >= 1,
              "the panel's backlight scales with the same level, never dark while the lights are on");
        bool mono = true;
        for (int p = DASH_PCT_MIN; p < DASH_PCT_MAX; p++)
            if (dash_pwm((uint8_t)(p + 1)) < dash_pwm((uint8_t)p) || light_back((uint8_t)(p + 1)) < light_back((uint8_t)p)) mono = false;
        CHECK(mono, "both rise with the level, never fall");

        lights_in_t in; memset(&in, 0, sizeof in); lights_out_t o;
        in.pmu_alive = 1; in.key_pos = KEY_RUN; in.headlight = HL_HEAD; in.dash_pct = 30; in.recirc = 1;
        lights_step(&in, &o);
        CHECK(o.panel[LP_RING0] == light_back(30) && o.plate[LQ_MIRROR] == light_back(30) && o.panel[LP_RECIRC] == LIGHT_FULL,
              "lights on at 30 %: the backlights at 30 %, a function that is on still at full");
        in.headlight = HL_OFF; lights_step(&in, &o);
        CHECK(o.panel[LP_RING0] == 0, "lights off: the backlights dark whatever the level");

        /* the centre knob: hold the push a second, turn, rest */
        dcu_state_t s = fresh(); knob_t k; memset(&k, 0, sizeof k); panel_t p; memset(&p, 0, sizeof p);
        screen_t sc; uint16_t down = 0, held = 0; uint32_t t = 800000; uint8_t seen_fan = 0;
        uint8_t target = s.mem.target_c, blower = s.mem.blower;
        for (int i = 0; i < 400 && k.mode != KNOB_DASH; i++, t += 5) {     /* the push down, held */
            uint16_t pr = panel_keys_step(&p, PK_CENTRE_PUSH, 1, t, &down, &held);
            knob_hold(&k, held, t);
            panel_apply(&s, &k, pr, 0, 0, 0, t);
            if (k.mode == KNOB_FAN) seen_fan = 1;
        }
        CHECK(seen_fan && k.mode == KNOB_DASH, "held: the fan first (the press), then the dash level");
        CHECK((held & PK_CENTRE_PUSH) && (uint32_t)(t - 800000) >= KNOB_DASH_HOLD_MS && (uint32_t)(t - 800000) < KNOB_DASH_HOLD_MS + 100,
              "after one second of the push, as 0x400's held bit");
        screen_build(&sc, &k, &s.mem, 12);
        CHECK(sc.page == SCR_DASH && !strcmp(sc.dash, "100") && !sc.temp[0] && sc.fan_bars == -1 && !sc.mode[0] && !sc.outside[0],
              "the screen shows the level alone");
        for (int i = 0; i < 100; i++, t += 5) {                             /* still held: stays, no re-entry */
            uint16_t pr = panel_keys_step(&p, PK_CENTRE_PUSH, 1, t, &down, &held);
            knob_hold(&k, held, t); panel_apply(&s, &k, pr, 0, 0, 0, t);
        }
        for (int i = 0; i < 10; i++, t += 5) {                              /* let go */
            uint16_t pr = panel_keys_step(&p, 0, 1, t, &down, &held);
            knob_hold(&k, held, t); panel_apply(&s, &k, pr, 0, 0, 0, t);
        }
        CHECK(k.mode == KNOB_DASH, "let go: still setting the level");
        knob_hold(&k, 0, t); panel_apply(&s, &k, 0, -4, 0, 0, t += 10);
        CHECK(s.mem.dash_pct == 100 - 4 * DASH_PCT_STEP && s.mem.target_c == target && s.mem.blower == blower,
              "four detents down: 80 %, the temperature and the fan untouched");
        screen_build(&sc, &k, &s.mem, 12);
        CHECK(!strcmp(sc.dash, "80"), "the screen follows");
        panel_apply(&s, &k, 0, -50, 0, 0, t += 10);
        CHECK(s.mem.dash_pct == DASH_PCT_MIN, "turned far down: stops at the minimum");
        panel_apply(&s, &k, 0, 50, 0, 0, t += 10);
        CHECK(s.mem.dash_pct == DASH_PCT_MAX, "and at full");
        panel_apply(&s, &k, 0, -2, 0, 0, t += 10);
        panel_apply(&s, &k, 0, 0, 0, 0, t + KNOB_REST_MS - 1);
        CHECK(k.mode == KNOB_DASH, "1 ms short of the rest: still the level");
        panel_apply(&s, &k, 0, 0, 0, 0, t += KNOB_REST_MS);
        CHECK(k.mode == KNOB_TEMP && s.mem.dash_pct == 90, "rested 3 s: back to the temperature, the level kept");
        panel_apply(&s, &k, 0, 1, 0, 0, t += 10);
        CHECK(s.mem.dash_pct == 90 && s.mem.target_c == target + 1, "and a detent sets the temperature again");

        knob_hold(&k, PK_CENTRE_PUSH, t += 10);
        CHECK(k.mode == KNOB_DASH, "knob_hold: the held bit's rise enters the level");
        panel_apply(&s, &k, PK_CENTRE_PUSH, 0, 0, 0, t += 10);
        CHECK(k.mode == KNOB_FAN, "a push while setting the level is a fan push, as everywhere");
        knob_hold(&k, 0, t);

        s.mem.dash_pct = 3;                                                 /* a corrupt memory */
        knob_hold(&k, PK_CENTRE_PUSH, t += 10);
        panel_apply(&s, &k, 0, 1, 0, 0, t += 10);
        CHECK(s.mem.dash_pct == DASH_PCT_MIN + DASH_PCT_STEP, "a level below the range is read as the minimum first");

        /* the memory file: the new field is covered by the CRC */
        climate_mem_t a; mem_defaults(&a); a.crc = mem_crc(&a);
        climate_mem_t b = a; b.dash_pct = 50;
        CHECK(mem_crc(&b) != a.crc, "the level is in the CRC: a changed level is a changed file");

        /* random: the level stays in range, a rest always ends it */
        bool ok = true; uint32_t seed = 4242, last_ev = t;
        s = fresh(); memset(&k, 0, sizeof k);
        for (int i = 0; i < 100000 && ok; i++) {
            seed = seed * 1103515245u + 12345u;
            uint16_t pr = ((seed >> 16) & 31) == 0 ? PK_CENTRE_PUSH : 0;
            uint16_t hd = ((seed >> 21) & 63) == 0 ? PK_CENTRE_PUSH : 0;
            int det = ((seed >> 26) & 3) == 0 ? (int)((seed >> 12) % 9) - 4 : 0;
            t += (seed >> 3) & 511;
            knob_hold(&k, hd, t);
            panel_apply(&s, &k, pr, det, 0, 0, t);
            if (s.mem.dash_pct < DASH_PCT_MIN || s.mem.dash_pct > DASH_PCT_MAX) ok = false;
            if (pr || det || hd) last_ev = t;
            if ((uint32_t)(t - last_ev) >= KNOB_REST_MS && k.mode != KNOB_TEMP) ok = false;
        }
        CHECK(ok, "100k random holds, pushes and turns: the level in 10..100, home to the temperature after every rest");
    }

    /* ================= 27. the second expander U13: the wake request, the STATUS lines (Y11, D-577) ================= */
    {
        exp_model_fresh();
        tca9539_t u12, u13; memset(&u12, 0, sizeof u12); memset(&u13, 0, sizeof u13);
        exp_hal_reset(1);
        CHECK(!(exp2_pin_levels() & EXP2_WAKE), "in reset the wake request sits on its pull-down: no request");
        CHECK(exp_reset_init(&u12) == 1 && exp2_init(&u13) == 1, "boot: U12 reset and set up, then U13");
        CHECK(g_exp2.regs_written.size() == 3 && g_exp2.regs_written[0] == TCA_REG_OUTPUT0 && g_exp2.regs_written[2] == TCA_REG_CONFIG0
              && g_exp2.out == 0 && g_exp2.cfg == EXP2_INPUTS && g_exp2.reads == 1,
              "U13: outputs low before the directions, only the wake an output, INT cleared by a read");
        bool quiet = true;
        for (uint16_t q : g_exp2.pins) if (q & EXP2_WAKE) quiet = false;
        CHECK(quiet, "the wake request never rises during the reset or the set-up");
        CHECK(g_exp.cfg == EXP_INPUTS && g_exp.out == 0, "U12 untouched by U13's set-up");

        int r0 = g_exp.resets;
        CHECK(exp2_write_outputs(&u13, EXP2_WAKE) && (exp2_pin_levels() & EXP2_WAKE), "the wake request raised on P02");
        CHECK(g_exp.resets == r0 && g_exp2.regs_written.size() == 4, "one write, no reset");
        CHECK(exp2_write_outputs(&u13, EXP2_WAKE) && g_exp2.regs_written.size() == 4, "none for no change");
        CHECK(exp2_write_outputs(&u13, 0xFFFF) && g_exp2.out == EXP2_WAKE, "no other U13 port is ever driven");
        CHECK(exp2_write_outputs(&u13, 0) && !(exp2_pin_levels() & EXP2_WAKE), "and dropped");

        /* the wake request from the key path: asleep, a key pulls it; the PMU answers, it drops */
        panel_t p; memset(&p, 0, sizeof p); uint16_t down = 0, held = 0; uint32_t t = 900000;
        for (int i = 0; i < 6; i++, t += 5) {
            panel_keys_step(&p, PK_RECIRC, 0, t, &down, &held);
            exp2_write_outputs(&u13, p.wake_req ? EXP2_WAKE : 0);
        }
        CHECK(p.wake_req && (exp2_pin_levels() & EXP2_WAKE), "a key with the car asleep: the request on U13 P02");
        for (int i = 0; i < 2; i++, t += 5) {
            panel_keys_step(&p, PK_RECIRC, 1, t, &down, &held);
            exp2_write_outputs(&u13, p.wake_req ? EXP2_WAKE : 0);
        }
        CHECK(!p.wake_req && !(exp2_pin_levels() & EXP2_WAKE), "the PMU alive: dropped");

        /* the shared RESET: U12's fault clear drops U13's request, the set-up after it restores the port */
        exp2_write_outputs(&u13, EXP2_WAKE);
        g_exp2.pins.clear();
        exp_reset_init(&u12);
        bool dropped = false;
        for (uint16_t q : g_exp2.pins) if (!(q & EXP2_WAKE)) dropped = true;
        CHECK(dropped && g_exp2.cfg == 0xFFFF, "U12's reset pulse is U13's too: every port an input, the request on its pull-down");
        CHECK(exp2_init(&u13) == 1 && g_exp2.cfg == EXP2_INPUTS && u13.out == 0, "set up again after it, the request off until the next scan");

        /* the STATUS lines read */
        g_exp2.in = (uint16_t)(0xFFFF & ~EXP2_DASH_STATUS);
        CHECK(exp2_read_inputs(&u13) && !(u13.in & EXP2_DASH_STATUS) && (u13.in & EXP2_SEAT_STATUS),
              "the dash stage's STATUS low is seen, the seats' high");

        /* a silent U13: its own failure, U12 carries on */
        g_exp2.nack = true;
        CHECK(exp2_write_outputs(&u13, EXP2_WAKE) == 0 && u13.ok == 0 && u12.ok == 1, "U13 silent: known, U12 unaffected");
        CHECK(exp2_init(&u13) == 0, "re-set-up fails until it answers");
        g_exp2.nack = false;
        int r1 = g_exp.resets;
        CHECK(exp2_init(&u13) == 1 && g_exp.resets == r1, "answers again: set up without a reset - the mirrors are not put to sleep for it");
    }

    /* ================= 28. the screen knob (SN32, D-580, D-581) ================= */
    {
        uint8_t b[4] = { 0xFF, 0xFF, 0xFF, 0xFE };          /* the board's -2: two detents anticlockwise as it counts */
        CHECK(sknob_delta(b) == -2 * SKNOB_SIGN, "ENCODER_DELTA big-endian, signed, turned clockwise-positive");
        uint8_t g[4] = { 0xFE, 0xFF, 0xFF, 0xFF };          /* pin 24 low */
        CHECK(sknob_push(g) == 1, "the push: its pin low");
        g[0] = 0xFF;
        CHECK(sknob_push(g) == 0, "its pin high: up");
        uint8_t big[4] = { 0x00, 0x10, 0x00, 0x00 };
        CHECK(sknob_delta(big) == 0, "a garbled delta is dropped, not a spin");
        uint8_t fr[6]; sknob_pin_frame(fr, SS_GPIO_PULLENSET);
        CHECK(fr[0] == SS_GPIO_BASE && fr[1] == SS_GPIO_PULLENSET && fr[2] == 0x01 && fr[3] == 0 && fr[5] == 0,
              "the pull-up frame: GPIO base, the register, pin 24's mask big-endian");
        CHECK(SKNOB_ADDR == 0x36 && SKNOB_ADDR != LED_PANEL_ADDR && SKNOB_ADDR != LED_PLATE_ADDR,
              "0x36, apart from both LED drivers");

        climate_mem_t m; mem_defaults(&m);
        CHECK(m.disp_pct == DISP_PCT_MAX && disp_level(&m) == 100, "a fresh memory: the display at full");
        m.disp_pct = 0;
        CHECK(disp_level(&m) == 100, "a file from before the field (its padding, 0): full");

        sknob_t k; memset(&k, 0, sizeof k);
        uint8_t lvl = 100; uint32_t t = 5000;
        sknob_step(&k, &lvl, 0, 2, t);
        CHECK(k.mode == SKNOB_PAGES && k.count == 2 && lvl == 100, "at rest a detent steps the pages");
        sknob_step(&k, &lvl, 0, -3, t += 10);
        CHECK((int8_t)k.count == -1, "anticlockwise steps back; the count is signed and rolls");
        sknob_step(&k, &lvl, PK_SCREEN_PUSH, 0, t += 10);
        sknob_step(&k, &lvl, 0, 0, t += 200);
        CHECK(k.mode == SKNOB_BRIGHT, "a click: brightness");
        sknob_step(&k, &lvl, 0, 1, t += 10);
        CHECK(lvl == 95 && (int8_t)k.count == -1, "clockwise dimmer, 5 % a detent, the pages untouched");
        sknob_step(&k, &lvl, 0, -4, t += 10);
        CHECK(lvl == 100, "anticlockwise brighter, never past 100");
        sknob_step(&k, &lvl, 0, 30, t += 10);
        CHECK(lvl == DISP_PCT_MIN, "never below 10");
        sknob_step(&k, &lvl, 0, 0, t += SKNOB_REST_MS - 1);
        CHECK(k.mode == SKNOB_BRIGHT, "still brightness just under 3 s");
        sknob_step(&k, &lvl, 0, 0, t += 1);
        CHECK(k.mode == SKNOB_PAGES, "3 s at rest: back to pages");
        sknob_step(&k, &lvl, PK_SCREEN_PUSH, 0, t += 10); sknob_step(&k, &lvl, 0, 0, t += 100);
        CHECK(k.mode == SKNOB_BRIGHT, "click");
        sknob_step(&k, &lvl, PK_SCREEN_PUSH, 0, t += 500); sknob_step(&k, &lvl, 0, 0, t += 100);
        CHECK(k.mode == SKNOB_PAGES, "a second click: back to pages");
        sknob_step(&k, &lvl, PK_SCREEN_PUSH, 0, t += 10); sknob_step(&k, &lvl, PK_SCREEN_PUSH, 0, t += 3000);
        sknob_step(&k, &lvl, 0, 0, t += 10);
        CHECK(k.mode == SKNOB_PAGES, "a 3 s hold (pairing, the ICU's) is not a click");
        uint8_t c0 = k.count;
        sknob_step(&k, &lvl, PK_SCREEN_PUSH, 0, t += 10); sknob_step(&k, &lvl, PK_SCREEN_PUSH, 1, t += 100);
        sknob_step(&k, &lvl, 0, 0, t += 100);
        CHECK(k.mode == SKNOB_PAGES && k.count == (uint8_t)(c0 + 1), "turned while pushed: the page steps, no click");

        /* the push through the key path: debounced, held after 1 s, in 0x400 byte 1 b6 / byte 3 b6 */
        panel_t p; memset(&p, 0, sizeof p);
        uint16_t down = 0, held = 0; t = 90000;
        for (int i = 0; i < 10; i++, t += 5) panel_keys_step(&p, PK_SCREEN_PUSH, 1, t, &down, &held);
        CHECK(down == PK_SCREEN_PUSH && held == 0, "the push is a key: down after the debounce");
        for (int i = 0; i < 200; i++, t += 5) panel_keys_step(&p, PK_SCREEN_PUSH, 1, t, &down, &held);
        CHECK(held == PK_SCREEN_PUSH, "and held after a second");
        keys_tx_t tx; memset(&tx, 0, sizeof tx); panel_keys_t f;
        panel_frame_due(&tx, down, held, -5, 60, t, &f);
        const uint8_t *raw = (const uint8_t *)&f;
        CHECK((raw[1] & 0x40) && (raw[3] & 0x40) && (int8_t)raw[4] == -5 && raw[5] == 60,
              "on the wire: byte 1 b6, byte 3 b6, byte 4 the count, byte 5 the level");
    }

    printf("\n passed %d   failed %d\n", g_pass, g_fail);
    printf(g_fail ? " DCU TESTS FAILED\n" : " ALL DCU TESTS PASSED\n");
    return g_fail ? 1 : 0;
}
